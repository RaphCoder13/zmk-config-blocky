//
//                                                                      ▀  ▀  ▀
//
// ▄▄▄▄▄▄▄▄▄▄▄▄▄▄▄▄▄▄▄▄▄▄▄▄▄▄▄▄▄▄▄▄▄▄▄▄▄▄▄▄▄▄▄▄▄▄▄▄▄▄▄▄▄▄▄▄▄▄▄▄▄▄▄▄▄▄▄▄▄▄▄▄▄▄▄▄▄▄▄▄▄▄▄▄▄▄▄▄▄▄▄▄▄▄▄▄▄▄▄▄▄▄▄▄▄▄▄▄▄▄▄▄▄▄▄▄▄▄▄▄▄▄▄▄▄▄▄▄▄▄▄▄▄▄▄▄▄▄▄▄▄▄▄▄▄▄▄▄▄



// For unicode support.
#define HOST_OS 2

#include <behaviors.dtsi>
#include <dt-bindings/zmk/keys.h>
#include <dt-bindings/zmk/bt.h>
#include <dt-bindings/zmk/outputs.h>
#include <zmk-helpers/helper.h>
// #include "zmk-helpers/key-labels/blocky_keys.h"
#include "blocky_keys.h"
#include <locale/keys_fr.h>
#include <behaviors/rgbled_widget.dtsi>
#include <behaviors/num_word.dtsi>


#define XXX &none
#define ___ &trans


#define BASE 0
#define BASE_M 1
#define ACCENT_OSS 2
#define UC_ACCENT 3
#define SYM 4
#define NUMS 5
#define NAV 6
#define NAV_M 7
#define FUNCTION_L 8
#define APPS 9
#define EXCEL 10
#define SNAKE 11
#define CAMEL 12
#define KEBAB 13
#define PATH_CASE 14
#define SLSH_CASE 15

#define NUMS_TMP 16
#define NUMS_LOCK 17
#define NAV_TMP 18
#define NAV_LOCK 19
#define NAV_M_TMP 20
#define NAV_M_LOCK 21
#define EXCEL_TMP 22
#define EXCEL_LOCK 23

#define MOUSE 24
#define MOUSE_TP 25
#define MOUSE_SCR 26

#define HAS_MOUSE_KEYS
#define HAS_MOUSE_TP

#ifdef HAS_MOUSE_KEYS
  #include <dt-bindings/zmk/mouse.h>
  #include <behaviors/mouse_keys.dtsi>
#endif  // HAS_MOUSE_KEYS

#include <mouse_settings_keycodes.h>

#ifdef HAS_MOUSE_TP
  // We store the trackpoint settings in a separate file
  // to make organization a little easier.
//   #include <mouse_tp.dtsi>

#endif  // HAS_MOUSE_TP

#define STICKY_TOGGLE(name, layer)           \
  name: sticky_layer_toggle##name {  \
    compatible = "zmk,behavior-tap-dance";   \
    #binding-cells = <0>;                    \
    bindings = <&sl layer>, <&tog layer>;    \
  }

#undef ZMK_LEADER_SEQUENCE
#define ZMK_LEADER_SEQUENCE(name, leader_bindings, leader_sequence) \
    / { \
        behaviors { \
            leader: leader { \
                compatible = "zmk,behavior-leader-key"; \
                #binding-cells = <0>; \
                ignore-keys = <LSHFT RSHFT>; \
                leader_sequence_ ## name { \
                    bindings = <leader_bindings>; \
                    sequence = <leader_sequence>; \
                }; \
            }; \
        }; \
    };

// #ifdef HAS_MOUSE
#include <zephyr/dt-bindings/input/input-event-codes.h>

/ {
    zip_temp_layer: zip_temp_layer {
        compatible = "zmk,input-processor-temp-layer";
        #input-processor-cells = <2>;
        require-prior-idle-ms = <1000>;
    };
};

&zip_scroll_scaler {
    track-remainders;
};

&trackpoint_listener {
    input-processors = <&zip_xy_transform (INPUT_TRANSFORM_Y_INVERT)>,<&zip_temp_layer MOUSE_TP 500 >;
    // input-processors = <&zip_xy_transform (INPUT_TRANSFORM_Y_INVERT)>,<&zip_xy_transform (INPUT_TRANSFORM_X_INVERT)>,<&zip_temp_layer MOUSE 1000>;
    scroller {
        layers = <MOUSE_SCR>;
        input-processors = <&zip_xy_to_scroll_mapper>,<&zip_scroll_scaler 1 8>;
    };
};

// #endif
#undef COMBO_TERM
#define COMBO_TERM 60

&caps_word {
    continue-list = <FR_UNDER DEL BSPC FR_M FR_CARET FR_UMLAUT>;
};

&sk {
    quick-release;
    release-after-ms = <1500>;
};


    &num_word {
        continue-list = <BSPC DEL
            FR_N0 FR_N1 FR_N2 FR_N3 FR_N4 FR_N5 FR_N6 FR_N7 FR_N8 FR_N9
            FR_DOT FR_COMMA FR_PLUS FR_MINUS FR_ASTRK FR_SLASH FR_EQUAL FR_RPAR FR_LPAR
            KP_N1 KP_N2 KP_N3 KP_N4 KP_N5 KP_N6 KP_N7 KP_N8 KP_N9 KP_N0
            KP_DOT KP_PLUS KP_MINUS KP_ASTERISK KP_SLASH
            >;
        ignore-modifiers;
    };

/ {
    behaviors {
        sknq: sticky_key_no_quick_release {
            compatible = "zmk,behavior-sticky-key";
            #binding-cells = <1>;
            bindings = <&kp>;
            release-after-ms = <2000>;
            lazy;
            ignore-modifiers;
        };
        skl: sticky_key_lazy {
            compatible = "zmk,behavior-sticky-key";
            #binding-cells = <1>;
            bindings = <&kp>;
            release-after-ms = <2000>;
            lazy;
            quick-release;
            ignore-modifiers;
        };
    };
};

/ {
    behaviors {
        mouse_reset: behavior_mouse_reset {
            compatible = "zmk,behavior-mouse-reset";
            label = "MOUSE_RESET";
            #binding-cells = <0>;
        };
    };
};


&lt {
    quick-tap-ms = <200>;
};


&mt {
  quick-tap-ms = <200>;
  flavor = "tap-preferred";
  tapping-term-ms = <170>;
};


    // Timeless homerow mods
    #define KEYS_L LT0 LT1 LT2 LT3 LT4 LM0 LM1 LM2 LM3 LM4 LM5 LB0 LB1 LB2 LB3 LB4 LB5
    #define KEYS_R RT0 RT1 RT2 RT3 RT4 RM0 RM1 RM2 RM3 RM4 RM5 RB0 RB1 RB2 RB3 RB4 RB5
    #define THUMBS LH0 LH1 LH2 RH0 RH1 RH2


    ZMK_HOLD_TAP(hml,
        flavor = "balanced";
        tapping-term-ms = <280>;
        require-prior-idle-ms = <150>;
        quick-tap-ms = <200>;
        hold-trigger-key-positions = <KEYS_R THUMBS>;
        hold-trigger-on-release;
        bindings = <&kp>, <&kp>;
    )

    ZMK_HOLD_TAP(hmr,
        flavor = "balanced";
        tapping-term-ms = <280>;
        require-prior-idle-ms = <150>;
        hold-trigger-key-positions = <KEYS_L THUMBS>;
        hold-trigger-on-release;
        quick-tap-ms = <200>;
        bindings = <&kp>, <&kp>;
    )

    // Base layer
    ZMK_MOD_MORPH(minus_slash, bindings = <&kp FR_MINUS>, <&kp FR_SLASH>; mods = <(MOD_LSFT|MOD_RSFT)>;)
    ZMK_MOD_MORPH(comma_semi, bindings = <&kp FR_COMMA>, <&kp FR_SEMICOLON>; mods = <(MOD_LSFT|MOD_RSFT)>;)
    ZMK_MOD_MORPH(dot_colon, bindings = <&kp FR_DOT>, <&kp FR_COLON>; mods = <(MOD_LSFT|MOD_RSFT)>;)
    ZMK_MOD_MORPH(under_qmark, bindings = <&kp FR_UNDERSCORE>, <&kp FR_QUESTION>; mods = <(MOD_LSFT|MOD_RSFT)>;)

    ZMK_MOD_MORPH(dead_caret, bindings= <&kp FR_CARET>, <&none>; mods = <(MOD_LSFT|MOD_RSFT)>;)

    // Macros pour les lettres accentuées minuscules et majuscules
    ZMK_MACRO(fr_a_circ, bindings = <&kp FR_CARET &kp FR_A>;)
    ZMK_MACRO(fr_e_circ, bindings = <&kp FR_CARET &kp FR_E>;)
    ZMK_MACRO(fr_i_circ, bindings = <&kp FR_CARET &kp FR_I>;)
    ZMK_MACRO(fr_o_circ, bindings = <&kp FR_CARET &kp FR_O>;)
    ZMK_MACRO(fr_u_circ, bindings = <&kp FR_CARET &kp FR_U>;)

    ZMK_MACRO(fr_a_trem, bindings = <&kp LS(FR_CARET) &kp FR_A>;)
    ZMK_MACRO(fr_e_trem, bindings = <&kp LS(FR_CARET) &kp FR_E>;)
    ZMK_MACRO(fr_i_trem, bindings = <&kp LS(FR_CARET) &kp FR_I>;)
    ZMK_MACRO(fr_o_trem, bindings = <&kp LS(FR_CARET) &kp FR_O>;)
    ZMK_MACRO(fr_u_trem, bindings = <&kp LS(FR_CARET) &kp FR_U>;)


    ZMK_MACRO(fr_maj_A_trem, bindings = <&kp LS(FR_CARET) &kp LS(FR_A)>;)
    ZMK_MACRO(fr_maj_E_trem, bindings = <&kp LS(FR_CARET) &kp LS(FR_E)>;)
    ZMK_MACRO(fr_maj_I_trem, bindings = <&kp LS(FR_CARET) &kp LS(FR_I)>;)
    ZMK_MACRO(fr_maj_O_trem, bindings = <&kp LS(FR_CARET) &kp LS(FR_O)>;)
    ZMK_MACRO(fr_maj_U_trem, bindings = <&kp LS(FR_CARET) &kp LS(FR_U)>;)

    ZMK_MACRO(fr_maj_A_circ, bindings = <&kp FR_CARET &kp LS(FR_A)>;)
    ZMK_MACRO(fr_maj_E_circ, bindings = <&kp FR_CARET &kp LS(FR_E)>;)
    ZMK_MACRO(fr_maj_I_circ, bindings = <&kp FR_CARET &kp LS(FR_I)>;)
    ZMK_MACRO(fr_maj_O_circ, bindings = <&kp FR_CARET &kp LS(FR_O)>;)
    ZMK_MACRO(fr_maj_U_circ, bindings = <&kp FR_CARET &kp LS(FR_U)>;)

    ZMK_MOD_MORPH(fr_a_tremM, bindings = <&fr_a_trem>, <&fr_maj_A_trem>; mods = <(MOD_LSFT|MOD_RSFT)>;)
    ZMK_MOD_MORPH(fr_e_tremM, bindings = <&fr_e_trem>, <&fr_maj_E_trem>; mods = <(MOD_LSFT|MOD_RSFT)>;)
    ZMK_MOD_MORPH(fr_i_tremM, bindings = <&fr_i_trem>, <&fr_maj_I_trem>; mods = <(MOD_LSFT|MOD_RSFT)>;)
    ZMK_MOD_MORPH(fr_o_tremM, bindings = <&fr_o_trem>, <&fr_maj_O_trem>; mods = <(MOD_LSFT|MOD_RSFT)>;)
    ZMK_MOD_MORPH(fr_u_tremM, bindings = <&fr_u_trem>, <&fr_maj_U_trem>; mods = <(MOD_LSFT|MOD_RSFT)>;)
    ZMK_MOD_MORPH(fr_a_circM, bindings = <&fr_a_circ>, <&fr_maj_A_circ>; mods = <(MOD_LSFT|MOD_RSFT)>;)
    ZMK_MOD_MORPH(fr_e_circM, bindings = <&fr_e_circ>, <&fr_maj_E_circ>; mods = <(MOD_LSFT|MOD_RSFT)>;)
    ZMK_MOD_MORPH(fr_i_circM, bindings = <&fr_i_circ>, <&fr_maj_I_circ>; mods = <(MOD_LSFT|MOD_RSFT)>;)
    ZMK_MOD_MORPH(fr_o_circM, bindings = <&fr_o_circ>, <&fr_maj_O_circ>; mods = <(MOD_LSFT|MOD_RSFT)>;)
    ZMK_MOD_MORPH(fr_u_circM, bindings = <&fr_u_circ>, <&fr_maj_U_circ>; mods = <(MOD_LSFT|MOD_RSFT)>;)


    // Majuscules pour les accents des touches existantes en mode FR_OSS
    ZMK_MOD_MORPH(fr_a_graveM,  bindings = <&kp FR_A_GRAVE>, <&kp RA(LS(FR_A_GRAVE))>; mods = <(MOD_LSFT|MOD_RSFT)>;)
    ZMK_MOD_MORPH(fr_e_graveM,  bindings = <&kp FR_E_GRAVE>, <&kp RA(LS(FR_E_GRAVE))>; mods = <(MOD_LSFT|MOD_RSFT)>;)
    ZMK_MOD_MORPH(fr_e_acuteM,  bindings = <&kp FR_E_ACUTE>, <&kp RA(LS(FR_E_ACUTE))>; mods = <(MOD_LSFT|MOD_RSFT)>;)
    ZMK_MOD_MORPH(fr_c_cedillaM,bindings = <&kp FR_C_CEDILLA>, <&kp RA(LS(FR_C_CEDILLA))>; mods = <(MOD_LSFT|MOD_RSFT)>;)
    ZMK_MOD_MORPH(fr_u_graveM,  bindings = <&kp FR_U_GRAVE>, <&kp RA(LS(FR_U_GRAVE))>; mods = <(MOD_LSFT|MOD_RSFT)>;)

    // Gestion accents et majuscules en mode unicode
    UC_MACRO(u_fr_a_graveM ,    &kp KP_N0 &kp KP_N1 &kp KP_N9 &kp KP_N2)  // à(0224)/À(0192)
    UC_MACRO(u_fr_e_graveM ,    &kp KP_N0 &kp KP_N2 &kp KP_N0 &kp KP_N0)  // è(0232)/È(0200)
    UC_MACRO(u_fr_e_acuteM ,    &kp KP_N0 &kp KP_N2 &kp KP_N0 &kp KP_N1)  // é(0233)/É(0201)
    UC_MACRO(u_fr_c_cedillaM ,  &kp KP_N0 &kp KP_N1 &kp KP_N9 &kp KP_N9)  // ç(0231)/Ç(0199)
    UC_MACRO(u_fr_u_graveM ,    &kp KP_N0 &kp KP_N2 &kp KP_N1 &kp KP_N7)  // ù(0249)/Ù(0217)

    ZMK_MOD_MORPH(u_fr_a_grave,   bindings = <&kp FR_A_GRAVE>, <&u_fr_a_graveM>; mods = <(MOD_LSFT|MOD_RSFT)>;)
    ZMK_MOD_MORPH(u_fr_e_grave,   bindings = <&kp FR_E_GRAVE>, <&u_fr_e_graveM>; mods = <(MOD_LSFT|MOD_RSFT)>;)
    ZMK_MOD_MORPH(u_fr_e_acute,   bindings = <&kp FR_E_ACUTE>, <&u_fr_e_acuteM>; mods = <(MOD_LSFT|MOD_RSFT)>;)
    ZMK_MOD_MORPH(u_fr_c_cedilla, bindings = <&kp FR_C_CEDILLA>, <&u_fr_c_cedillaM>; mods = <(MOD_LSFT|MOD_RSFT)>;)
    ZMK_MOD_MORPH(u_fr_u_grave,   bindings = <&kp FR_U_GRAVE>, <&u_fr_u_graveM>; mods = <(MOD_LSFT|MOD_RSFT)>;)

    ZMK_UNICODE_PAIR(u_fr_ae,           KP_N0, KP_N2, KP_N3, KP_N0,  KP_N0, KP_N1, KP_N9, KP_N8)  // æ(0230)/Æ(0198)
    ZMK_UNICODE_PAIR(u_fr_oe,           KP_N0, KP_N1, KP_N5, KP_N6,  KP_N0, KP_N1, KP_N4, KP_N0)  // œ(0156)/Œ(0140)
    ZMK_UNICODE_PAIR(u_fr_a_circumflex, KP_N0, KP_N2, KP_N2, KP_N6,  KP_N0, KP_N1, KP_N9, KP_N4)  // â(0226)/Â(0194)
    ZMK_UNICODE_PAIR(u_fr_e_circumflex, KP_N0, KP_N2, KP_N3, KP_N4,  KP_N0, KP_N2, KP_N0, KP_N2)  // ê(0234)/Ê(0202)
    ZMK_UNICODE_PAIR(u_fr_e_diaeresis,  KP_N0, KP_N2, KP_N3, KP_N5,  KP_N0, KP_N2, KP_N0, KP_N3)  // ë(0235)/Ë(0203)
    ZMK_UNICODE_PAIR(u_fr_i_circumflex, KP_N0, KP_N2, KP_N3, KP_N8,  KP_N0, KP_N2, KP_N0, KP_N6)  // î(0238)/Î(0206)
    ZMK_UNICODE_PAIR(u_fr_i_diaeresis,  KP_N0, KP_N2, KP_N3, KP_N9,  KP_N0, KP_N2, KP_N0, KP_N7)  // ï(0239)/Ï(0207)
    ZMK_UNICODE_PAIR(u_fr_o_circumflex, KP_N0, KP_N2, KP_N4, KP_N4,  KP_N0, KP_N2, KP_N1, KP_N2)  // ô(0244)/Ô(0212)
    ZMK_UNICODE_PAIR(u_fr_u_circumflex, KP_N0, KP_N2, KP_N5, KP_N1,  KP_N0, KP_N2, KP_N1, KP_N9)  // û(0251)/Û(0219)
    ZMK_UNICODE_PAIR(u_fr_u_diaeresis,  KP_N0, KP_N2, KP_N5, KP_N2,  KP_N0, KP_N2, KP_N2, KP_N0)  // ü(0252)/Ü(0220)
    ZMK_UNICODE_PAIR(u_fr_y_diaeresis,  KP_N0, KP_N2, KP_N5, KP_N5,  KP_N0, KP_N1, KP_N5, KP_N9)  // ÿ(0255)/Ÿ(0159)

    ZMK_UNICODE_PAIR(u_plus_minus, KP_N0, KP_N1, KP_N7, KP_N7, KP_N0, KP_N1, KP_N7, KP_N7)
    ZMK_UNICODE_PAIR(u_fr_apostrophe, KP_N0, KP_N1, KP_N4, KP_N6, KP_N0, KP_N1, KP_N4, KP_N6)
    ZMK_UNICODE_PAIR(u_fr_daqleft, KP_N0, KP_N1, KP_N7, KP_N1, KP_N0, KP_N1, KP_N4, KP_N7)
    ZMK_UNICODE_PAIR(u_fr_daqright, KP_N0, KP_N1, KP_N8, KP_N7, KP_N0, KP_N1, KP_N4, KP_N8)
    ZMK_UNICODE_PAIR(u_fr_tiret_quad, KP_N0, KP_N1, KP_N5, KP_N0, KP_N0, KP_N1, KP_N5, KP_N1)
    ZMK_UNICODE_PAIR(u_fr_ellipsis, KP_N0, KP_N1, KP_N3, KP_N3, KP_N0, KP_N1, KP_N3, KP_N3)
    ZMK_UNICODE_PAIR(u_fr_nobreakspace, KP_N8, KP_N2, KP_N0, KP_N9, KP_N0, KP_N1, KP_N6, KP_N0)




    // Symbols mod_morphs
    ZMK_MOD_MORPH(at_mu, bindings = <&kp FR_AT>, <&kp FR_MICRO>; mods = <(MOD_LSFT|MOD_RSFT)>; )
    ZMK_MOD_MORPH(pct_minus, bindings = <&kp FR_PERCENT>, <&kp FR_MINUS>; mods = <(MOD_LSFT|MOD_RSFT)>; )
    ZMK_MOD_MORPH(lt_apos, bindings = <&kp FR_LT>, <&kp RA(FR_G)>; mods = <(MOD_LSFT|MOD_RSFT)>; )
    ZMK_MOD_MORPH(gt_grave, bindings = <&kp FR_GT>, <&kp FR_GRAVE>; mods = <(MOD_LSFT|MOD_RSFT)>; )
    ZMK_MOD_MORPH(lt_apos, bindings = <&kp FR_LT>, <&kp RA(FR_G)>; mods = <(MOD_LSFT|MOD_RSFT)>; )
    ZMK_MOD_MORPH(gt_grave, bindings = <&kp FR_GT>, <&kp FR_GRAVE>; mods = <(MOD_LSFT|MOD_RSFT)>; )
    ZMK_MOD_MORPH(sqt_dqt, bindings = <&kp FR_SQT>, <&kp FR_DQT>; mods = <(MOD_LSFT|MOD_RSFT)>; )
    ZMK_MOD_MORPH(hash_tilde, bindings = <&kp FR_HASH>, <&kp FR_TILDE>; mods = <(MOD_LSFT|MOD_RSFT)>; )
    ZMK_MOD_MORPH(excl_sqr, bindings = <&kp FR_EXCL>, <&kp FR_SQUARE>; mods = <(MOD_LSFT|MOD_RSFT)>; )
    ZMK_MOD_MORPH(lpar_rpar, bindings = <&kp FR_LPAR>, <&kp FR_RPAR>; mods = <(MOD_LSFT|MOD_RSFT)>; )
    ZMK_MOD_MORPH(lpar_semicol, bindings = <&kp FR_LPAR>, <&kp FR_SEMICOLON>; mods = <(MOD_LSFT|MOD_RSFT)>; )
    ZMK_MOD_MORPH(rpar_dqt, bindings = <&kp FR_RPAR>, <&kp FR_DQT>; mods = <(MOD_LSFT|MOD_RSFT)>; )
    ZMK_MOD_MORPH(equal_plus, bindings = <&kp FR_EQUAL>, <&kp FR_PLUS>; mods = <(MOD_LSFT|MOD_RSFT)>; )
    ZMK_MOD_MORPH(and_pipe, bindings = <&kp FR_AMPERSAND>, <&kp FR_PIPE>; mods = <(MOD_LSFT|MOD_RSFT)>; )
    ZMK_MOD_MORPH(lbrc_rbrc, bindings = <&kp FR_LBRC>, <&kp FR_RBRC>; mods = <(MOD_LSFT|MOD_RSFT)>; )
    ZMK_MOD_MORPH(hash_tild, bindings = <&kp FR_HASH>, <&kp FR_TILDE>; mods = <(MOD_LSFT|MOD_RSFT)>; )
    ZMK_MOD_MORPH(aster_fslh, bindings = <&kp FR_ASTERISK>, <&kp FR_FSLH>; mods = <(MOD_LSFT|MOD_RSFT)>; )
    ZMK_MOD_MORPH(bslh_deg, bindings = <&kp FR_BSLH>, <&kp FR_DEG>; mods = <(MOD_LSFT|MOD_RSFT)>; )
    ZMK_MOD_MORPH(doll_pnd, bindings = <&kp FR_DOLLAR>, <&kp FR_POUND_SIGN>; mods = <(MOD_LSFT|MOD_RSFT)>; )
    ZMK_MOD_MORPH(kp_l_r_par, bindings = <&kp FR_LPAR>, <&kp FR_RPAR>; mods = <(MOD_LSFT|MOD_RSFT)>; )


    // Reset and Bootloader
    ZMK_MOD_MORPH(reset_bootloader, bindings=<&sys_reset>, <&bootloader>; mods = <(MOD_LSFT|MOD_RSFT)>;)
    ZMK_TAP_DANCE(td_reset, bindings=<&none>, <&none>, <&reset_bootloader>;)

    // Macros
    ZMK_MACRO(qu_macro, bindings=<&kp FR_Q &kp FR_U>;)
    ZMK_MACRO(vim_syst_clip, bindings=<&kp FR_DQT &kp FR_PLUS>;)
    ZMK_MACRO(vim_last_yank, bindings=<&kp FR_DQT &kp FR_N0>;)

    // Combos
    ZMK_COMBO(qu,        &qu_macro,     LT4 LT3, BASE)
    ZMK_COMBO(td_colon,  &kp FR_COLON,  LM1 LB1, BASE )
    ZMK_COMBO(tp_semicolon,  &kp FR_SEMICOLON,  LM1 LT1, BASE )
    ZMK_COMBO(sc_0,      &kp FR_N0,     LM2 LB2, BASE )

    ZMK_COMBO(nh_circ,   &kp RA(FR_C_CEDILLA),  RM1 RB1, BASE )
    ZMK_COMBO(ecomm_dol, &kp FR_DOLLAR,    RM2 RB2, BASE )
    // ZMK_COMBO(mn_semi,   &kp FR_SEMICOLON, RM0 RM1, BASE BASE_M)

    // Mouse layer access
    // ZMK_COMBO(mo_mouse,  &smart_mouse,   LM5 LB5)   // !not working (maybe because LB5 is not ignored)
    ZMK_COMBO(mo_mouse,  &smart_mouse,   LT2 LT3, BASE)

    // Locking num layer with toggle
    ZMK_COMBO(tog_nav,   &tog NAV_LOCK,     RM5 RB5, NAV_TMP NAV_LOCK)
    ZMK_COMBO(tog_num,   &tog NUMS_LOCK,    RM5 RB5, NUMS_TMP NUMS_LOCK)
    ZMK_COMBO(tog_excel, &tog EXCEL_LOCK,   RM5 RB5, EXCEL_TMP EXCEL_LOCK)

    ZMK_CONDITIONAL_LAYER(nums_lock, NUMS_LOCK, NUMS)
    ZMK_CONDITIONAL_LAYER(nums_temp, NUMS_TMP, NUMS)
    ZMK_CONDITIONAL_LAYER(nav_lock, NAV_LOCK, NAV)
    ZMK_CONDITIONAL_LAYER(nav_temp, NAV_TMP, NAV)
    ZMK_CONDITIONAL_LAYER(nav_m_lock, NAV_M_LOCK, NAV_M)
    ZMK_CONDITIONAL_LAYER(nav_m_temp, NAV_M_TMP, NAV_M)
    ZMK_CONDITIONAL_LAYER(excel_lock, EXCEL_LOCK, EXCEL)
    ZMK_CONDITIONAL_LAYER(excel_temp, EXCEL_TMP, EXCEL)

    // Leader sequences
    // ----------------
    // Infos persos
    #include "perso.dtsi"
    ZMK_LEADER_SEQUENCE(first_name,    &macro_first_name, R P)
    ZMK_LEADER_SEQUENCE(last_name,   &macro_last_name, R D)
    ZMK_LEADER_SEQUENCE(telephone,  &macro_tel, R T)

    ZMK_LEADER_SEQUENCE(mail_free,  &macro_mail_free, R FR_M F)
    ZMK_LEADER_SEQUENCE(mail_gmail,  &macro_mail_gmail, R FR_M G)
    ZMK_LEADER_SEQUENCE(mail_cdl,   &macro_mail_cdl, R FR_M C)

    // Case mods launches
    ZMK_LEADER_SEQUENCE(snake_mod,  &case_mod SNAKE, S)
    ZMK_LEADER_SEQUENCE(camel_mod,  &case_mod CAMEL, C)
    ZMK_LEADER_SEQUENCE(kebab_mod,  &case_mod KEBAB, K)
    ZMK_LEADER_SEQUENCE(path_mod,  &case_mod PATH_CASE, FR_D)
    ZMK_LEADER_SEQUENCE(slsh_mod,  &case_mod SLSH_CASE, FR_V)
    ZMK_LEADER_SEQUENCE(pascal_mod, &pascal_case, P)
    ZMK_LEADER_SEQUENCE(constant_mod, &constant_case, T)
    ZMK_LEADER_SEQUENCE(numpad_numword, &num_word EXCEL_LOCK, N)
    ZMK_LEADER_SEQUENCE(numleft_numword, &num_word NUMS_LOCK, FR_M)

    // case mods with urob's zmk-auto-layer
    ZMK_MACRO(pascal_case, bindings=<&macro_tap &sk LSHFT>, <&case_mod CAMEL>;)
    ZMK_AUTO_LAYER(case_mod, ignore-alphas; ignore-numbers; ignore-modifiers;continue-list=<SPACE FR_UNDER FR_MINUS DEL BSPC LEFT RIGHT FR_BSLH FR_SLASH FR_M>;)
    ZMK_MACRO(constant_case, bindings=<&caps_word>, <&case_mod SNAKE>;)

    // Change space to case mod separator with adaptive-key
    ZMK_ADAPTIVE_KEY(ak_camel, bindings=<&sk LSHFT>; akt_shft {trigger-keys=<LSHFT>; bindings=<&end_camel>;};)
    ZMK_ADAPTIVE_KEY(ak_snake, bindings=<&kp FR_UNDER>; akt_snake {trigger-keys=<FR_UNDER>; bindings=<&end_sep_mod>;};)
    ZMK_ADAPTIVE_KEY(ak_kebab, bindings=<&kp FR_MINUS>; akt_kebab {trigger-keys=<FR_MINUS>; bindings=<&end_sep_mod>;};)
    ZMK_ADAPTIVE_KEY(ak_bslh, bindings=<&kp FR_BSLH>; akt_bslh {trigger-keys=<FR_BSLH>; bindings=<&end_sep_mod>;};)
    ZMK_ADAPTIVE_KEY(ak_slash, bindings=<&kp FR_SLASH>; akt_slash {trigger-keys=<FR_SLASH>; bindings=<&end_sep_mod>;};)

    // Ending case mods after pressing space 2 times
    ZMK_MACRO(end_sep_mod, bindings=<&kp BSPC &kp SPACE>, <&to BASE>;)
    ZMK_MACRO(end_camel, bindings=<&to BASE &kp SPACE>, <&to BASE>;)


    // Tap dance for shift/sticky shift/caps word/caps lock
    ZMK_TAP_DANCE(td_shft_capw, bindings=<&sk LSHFT>, <&caps_word>, <&kp CAPS>; tapping-term-ms=<350>;)


    // Smart-mouse, requires tri-state module.
    ZMK_TRI_STATE(
        smart_mouse, bindings = <&tog MOUSE>, <&none>, <&tog MOUSE>;
        ignored-key-positions =
            <LT1 LT2 LT3 LM0 LM1 LM2 LM3 LM4 LB0 LB1 LH0 LH1 LH2 RT0 RT1 RT2 RT3 RM0 RM1 RM2 RM3 RB1 RB3 RH0 RH1 RH2>;
        ignored-layers = <MOUSE NAV>;)


/ {
    aliases {
        led-red = &led0;
        led-green = &led1;
        led-blue = &led2;
    };

    leds {
        status = "okay";
    };


    behaviors {
        // Gestion swap hands pour layer BASE et NAV
        STICKY_TOGGLE(sl_togBaseM, BASE_M);
        STICKY_TOGGLE(sl_togNavM, NAV_M_TMP);

        t_off: toggle_layer_off {
            compatible = "zmk,behavior-toggle-layer";
            #binding-cells = <1>;
            label = "Toggle Layer Off";
            toggle-mode = "off";
        };

    };

    chosen {
        zmk,kscan = &kscan0;
        zmk,physical-layout = &physical_layout0;
    };

    keymap {
            compatible = "zmk,keymap";
// ▄▄▄▄▄▄▄▄▄▄▄▄▄▄▄▄▄▄▄▄▄▄▄▄▄▄▄▄▄▄▄▄▄▄▄▄▄▄▄▄▄▄▄▄▄▄▄▄▄▄▄▄▄▄▄▄▄▄▄▄▄▄▄▄▄▄▄▄▄▄▄▄▄▄▄▄▄▄▄▄▄▄▄▄▄▄▄▄▄▄▄▄▄▄▄▄▄▄▄▄▄▄▄▄▄▄▄▄▄▄▄▄▄▄▄▄▄▄▄▄▄▄▄▄▄▄▄▄▄▄▄▄▄▄▄▄▄▄▄▄▄▄▄▄▄▄▄▄▄

base_layer {
// ┏━━━━━━━━━━━━━━━━━━━━━━━━━━━━━━━━━━━━━━━┓
display-name= "BASE"                              ;
// ┗━━━━━━━━━━━━━━━━━━━━━━━━━━━━━━━━━━━━━━━┛
//             ┏━━━━━━━━━━━━━┳━━━━━━━━━━━━━┳━━━━━━━━━━━━━┳━━━━━━━━━━━━━┳━━━━━━━━━━━━━┓   ┏━━━━━━━━━━━━━┳━━━━━━━━━━━━━┳━━━━━━━━━━━━━┳━━━━━━━━━━━━━┳━━━━━━━━━━━━━┓
//             ┃     Q       ┃     Z       ┃     F       ┃     P       ┃     B       ┃   ┃     J       ┃     L       ┃     O       ┃   dead      ┃     Y       ┃
// ┏━━━━━━━━━━━╋━━━━━━━━━━━━━╋━━━━━━━━━━━━━╋━━━━━━━━━━━━━╋━━━━━━━━━━━━━╋━━━━━━━━━━━━━┫   ┣━━━━━━━━━━━━━╋━━━━━━━━━━━━━╋━━━━━━━━━━━━━╋━━━━━━━━━━━━━╋━━━━━━━━━━━━━╋━━━━━━━━━━━┓
// ┃  LSHFT    ┃     A       ┃     R       ┃     S       ┃     T       ┃     G       ┃   ┃     M       ┃     N       ┃     E       ┃     I       ┃     U       ┃   _ ?     ┃
// ┣━━━━━━━━━━━╋━━━━━━━━━━━━━╋━━━━━━━━━━━━━╋━━━━━━━━━━━━━╋━━━━━━━━━━━━━╋━━━━━━━━━━━━━┫   ┣━━━━━━━━━━━━━╋━━━━━━━━━━━━━╋━━━━━━━━━━━━━╋━━━━━━━━━━━━━╋━━━━━━━━━━━━━╋━━━━━━━━━━━┫
// ┃  swap     ┃     W       ┃     X       ┃     C       ┃     D       ┃     V       ┃   ┃     K       ┃     H       ┃    , ;      ┃    . :      ┃    - /      ┃  swap     ┃
// ┗━━━━━━━━━━━┻━━━━━━━━━━━━━┻━━━━━━━━━━━━━╋━━━━━━━━━━━━━╋━━━━━━━━━━━━━╋━━━━━━━━━━━━━┫   ┣━━━━━━━━━━━━━╋━━━━━━━━━━━━━╋━━━━━━━━━━━━━╋━━━━━━━━━━━━━┻━━━━━━━━━━━━━┻━━━━━━━━━━━┛
//                                         ┃    ESC      ┃    SPC      ┃    TAB      ┃   ┃   ENTER     ┃   BSPC      ┃   DELETE    ┃
//                                         ┗━━━━━━━━━━━━━┻━━━━━━━━━━━━━┻━━━━━━━━━━━━━┛   ┗━━━━━━━━━━━━━┻━━━━━━━━━━━━━┻━━━━━━━━━━━━━┛
 bindings = <
// ╷           ╷             ╷             ╷             ╷             ╷             ╷   ╷             ╷             ╷             ╷             ╷             ╷           ╷

                &kp FR_Q      &kp FR_Z      &kp F         &kp P         &kp B             &kp J         &kp L         &kp O         &sl UC_ACCENT    &kp FR_Y
&td_shft_capw   &hml LGUI FR_A &hml LALT R  &hml LSHFT S  &hml LCTRL T  &kp G             &kp FR_M      &hmr RCTRL N  &hmr RSHFT E  &hmr LALT I   &hmr RGUI U   &under_qmark
  &sl_togBaseM  &kp FR_W      &kp X         &kp C         &hml RALT D   &kp V             &kp K         &hmr RALT H   &comma_semi   &dot_colon    &minus_slash  &sl_togBaseM
                                &lt APPS ESC       &lt EXCEL_TMP SPACE     &lt NAV_TMP TAB        &lt NUMS_TMP RET       &lt SYM BSPC      &lt FUNCTION_L DEL
            >;
    };

base_M_layer {
// ┏━━━━━━━━━━━━━━━━━━━━━━━━━━━━━━━━━━━━━━━┓
display-name= "BASE_M"                              ;
// ┗━━━━━━━━━━━━━━━━━━━━━━━━━━━━━━━━━━━━━━━┛
//             ┏━━━━━━━━━━━━━┳━━━━━━━━━━━━━┳━━━━━━━━━━━━━┳━━━━━━━━━━━━━┳━━━━━━━━━━━━━┓   ┏━━━━━━━━━━━━━┳━━━━━━━━━━━━━┳━━━━━━━━━━━━━┳━━━━━━━━━━━━━┳━━━━━━━━━━━━━┓
//             ┃     Y       ┃   dead      ┃     O       ┃     L       ┃     J       ┃   ┃     B       ┃     P       ┃     F       ┃     Z       ┃     Q       ┃
// ┏━━━━━━━━━━━╋━━━━━━━━━━━━━╋━━━━━━━━━━━━━╋━━━━━━━━━━━━━╋━━━━━━━━━━━━━╋━━━━━━━━━━━━━┫   ┣━━━━━━━━━━━━━╋━━━━━━━━━━━━━╋━━━━━━━━━━━━━╋━━━━━━━━━━━━━╋━━━━━━━━━━━━━╋━━━━━━━━━━━┓
// ┃   / :     ┃     U       ┃     I       ┃     E       ┃     N       ┃     M       ┃   ┃     G       ┃     T       ┃     S       ┃     R       ┃     A       ┃  LSHFT    ┃
// ┣━━━━━━━━━━━╋━━━━━━━━━━━━━╋━━━━━━━━━━━━━╋━━━━━━━━━━━━━╋━━━━━━━━━━━━━╋━━━━━━━━━━━━━┫   ┣━━━━━━━━━━━━━╋━━━━━━━━━━━━━╋━━━━━━━━━━━━━╋━━━━━━━━━━━━━╋━━━━━━━━━━━━━╋━━━━━━━━━━━┫
// ┃  swap     ┃    . _      ┃    , ;      ┃    - ?      ┃     H       ┃     K       ┃   ┃     V       ┃     D       ┃     C       ┃     X       ┃     W       ┃  swap     ┃
// ┗━━━━━━━━━━━┻━━━━━━━━━━━━━┻━━━━━━━━━━━━━╋━━━━━━━━━━━━━╋━━━━━━━━━━━━━╋━━━━━━━━━━━━━┫   ┣━━━━━━━━━━━━━╋━━━━━━━━━━━━━╋━━━━━━━━━━━━━╋━━━━━━━━━━━━━┻━━━━━━━━━━━━━┻━━━━━━━━━━━┛
//                                         ┃   DELETE    ┃   BSPC      ┃   ENTER     ┃   ┃    TAB      ┃    SPC      ┃    ESC      ┃
//                                         ┗━━━━━━━━━━━━━┻━━━━━━━━━━━━━┻━━━━━━━━━━━━━┛   ┗━━━━━━━━━━━━━┻━━━━━━━━━━━━━┻━━━━━━━━━━━━━┛
 bindings = <
// ╷           ╷             ╷             ╷             ╷             ╷             ╷   ╷             ╷             ╷             ╷             ╷             ╷           ╷

                &kp FR_Y      &sl UC_ACCENT    &kp O         &kp L         &kp J             &kp B         &kp P         &kp F         &kp FR_Z      &kp FR_Q
   &under_qmark &hml RGUI U   &hml LALT I   &hml RSHFT E  &hml RCTRL N  &kp FR_M          &kp G         &hmr LCTRL T  &hmr LSHFT S  &hmr LALT R   &hmr LGUI FR_A &td_shft_capw
  &t_off BASE_M &minus_slash  &dot_colon    &comma_semi   &hml RALT H   &kp K             &kp V         &hmr RALT D   &kp C         &kp X         &kp FR_W      &t_off BASE_M
                                &lt FUNCTION_L DEL   &lt SYM BSPC      &lt NUMS_TMP RET       &lt NAV_TMP TAB     &lt EXCEL_TMP SPACE     &lt APPS ESC
            >;
    };

accent_oss_layer {
display-name= "ACCENT_OSS";
//             ┏━━━━━━━━━━━━━┳━━━━━━━━━━━━━┳━━━━━━━━━━━━━┳━━━━━━━━━━━━━┳━━━━━━━━━━━━━┓   ┏━━━━━━━━━━━━━┳━━━━━━━━━━━━━┳━━━━━━━━━━━━━┳━━━━━━━━━━━━━┳━━━━━━━━━━━━━┓
//             ┃     â       ┃     ï       ┃     î       ┃     û       ┃     '       ┃   ┃     œ       ┃             ┃     ô       ┃     ¨       ┃     ±       ┃
// ┏━━━━━━━━━━━╋━━━━━━━━━━━━━╋━━━━━━━━━━━━━╋━━━━━━━━━━━━━╋━━━━━━━━━━━━━╋━━━━━━━━━━━━━┫   ┣━━━━━━━━━━━━━╋━━━━━━━━━━━━━╋━━━━━━━━━━━━━╋━━━━━━━━━━━━━╋━━━━━━━━━━━━━╋━━━━━━━━━━━┓
// ┃  LSHFT    ┃     à       ┃     ë       ┃     ê       ┃     "       ┃     &       ┃   ┃     ’       ┃     é       ┃     è       ┃     µ       ┃     ù       ┃    /      ┃
// ┣━━━━━━━━━━━╋━━━━━━━━━━━━━╋━━━━━━━━━━━━━╋━━━━━━━━━━━━━╋━━━━━━━━━━━━━╋━━━━━━━━━━━━━┫   ┣━━━━━━━━━━━━━╋━━━━━━━━━━━━━╋━━━━━━━━━━━━━╋━━━━━━━━━━━━━╋━━━━━━━━━━━━━╋━━━━━━━━━━━┫
// ┃  swap     ┃     ae      ┃     €       ┃     ç       ┃     ^       ┃     \       ┃   ┃     «       ┃     »       ┃     ‑       ┃     …       ┃     !       ┃  swap     ┃
// ┗━━━━━━━━━━━┻━━━━━━━━━━━━━┻━━━━━━━━━━━━━╋━━━━━━━━━━━━━╋━━━━━━━━━━━━━╋━━━━━━━━━━━━━┫   ┣━━━━━━━━━━━━━╋━━━━━━━━━━━━━╋━━━━━━━━━━━━━╋━━━━━━━━━━━━━┻━━━━━━━━━━━━━┻━━━━━━━━━━━┛
//                                         ┃    ESC      ┃    SPC      ┃    TAB      ┃   ┃   ENTER     ┃   BSPC      ┃   DELETE    ┃
//                                         ┗━━━━━━━━━━━━━┻━━━━━━━━━━━━━┻━━━━━━━━━━━━━┛   ┗━━━━━━━━━━━━━┻━━━━━━━━━━━━━┻━━━━━━━━━━━━━┛
bindings = <
// ╷           ╷             ╷             ╷             ╷             ╷             ╷   ╷             ╷             ╷             ╷             ╷             ╷           ╷

                &kp RA(FR_Z)  &kp RA(K)     &kp RA(I)      &kp RA(U)     &kp FR_SQT        &kp RA(O)     XXX          &kp RA(P)             &kp FR_UMLAUT         &kp RA(LS(FR_EQUAL))
     ___        &fr_a_graveM  &kp RA(D)     &kp RA(R)      &kp DQT       &and_pipe         &kp RA(G)     &fr_e_acuteM &fr_e_graveM          &kp FR_MU             &fr_u_graveM    ___
     ___        &kp RA(FR_A)  &kp FR_EURO   &fr_c_cedillaM &kp FR_CARET  &kp FR_BSLH       &kp RA(FR_W)  &kp RA(FR_X) &kp FR_QUESTION       &kp LS(RA(FR_COMMA))  &kp LS(RA(FR_MINUS)) ___
                                            &kp RA(SPACE)  &kp RA(G)      ___               ___           ___           ___

        >;
    };

unicode_accent_layer {
display-name= "UNICODE_ACCENT";
//             ┏━━━━━━━━━━━━━┳━━━━━━━━━━━━━┳━━━━━━━━━━━━━┳━━━━━━━━━━━━━┳━━━━━━━━━━━━━┓   ┏━━━━━━━━━━━━━┳━━━━━━━━━━━━━┳━━━━━━━━━━━━━┳━━━━━━━━━━━━━┳━━━━━━━━━━━━━┓
//             ┃     â       ┃     ï       ┃     î       ┃     û       ┃     '       ┃   ┃     œ       ┃             ┃     ô       ┃     ¨       ┃     ±       ┃
// ┏━━━━━━━━━━━╋━━━━━━━━━━━━━╋━━━━━━━━━━━━━╋━━━━━━━━━━━━━╋━━━━━━━━━━━━━╋━━━━━━━━━━━━━┫   ┣━━━━━━━━━━━━━╋━━━━━━━━━━━━━╋━━━━━━━━━━━━━╋━━━━━━━━━━━━━╋━━━━━━━━━━━━━╋━━━━━━━━━━━┓
// ┃  LSHFT    ┃     à       ┃     ë       ┃     ê       ┃     "       ┃     &       ┃   ┃     ’       ┃     é       ┃     è       ┃     µ       ┃     ù       ┃    /      ┃
// ┣━━━━━━━━━━━╋━━━━━━━━━━━━━╋━━━━━━━━━━━━━╋━━━━━━━━━━━━━╋━━━━━━━━━━━━━╋━━━━━━━━━━━━━┫   ┣━━━━━━━━━━━━━╋━━━━━━━━━━━━━╋━━━━━━━━━━━━━╋━━━━━━━━━━━━━╋━━━━━━━━━━━━━╋━━━━━━━━━━━┫
// ┃  swap     ┃     ae      ┃     €       ┃     ç       ┃     ^       ┃     \       ┃   ┃     «       ┃     »       ┃     ‑       ┃     …       ┃     !       ┃  swap     ┃
// ┗━━━━━━━━━━━┻━━━━━━━━━━━━━┻━━━━━━━━━━━━━╋━━━━━━━━━━━━━╋━━━━━━━━━━━━━╋━━━━━━━━━━━━━┫   ┣━━━━━━━━━━━━━╋━━━━━━━━━━━━━╋━━━━━━━━━━━━━╋━━━━━━━━━━━━━┻━━━━━━━━━━━━━┻━━━━━━━━━━━┛
//                                         ┃    ESC      ┃    SPC      ┃    TAB      ┃   ┃   ENTER     ┃   BSPC      ┃   DELETE    ┃
//                                         ┗━━━━━━━━━━━━━┻━━━━━━━━━━━━━┻━━━━━━━━━━━━━┛   ┗━━━━━━━━━━━━━┻━━━━━━━━━━━━━┻━━━━━━━━━━━━━┛
bindings = <
// ╷           ╷             ╷             ╷             ╷             ╷             ╷   ╷             ╷             ╷             ╷             ╷             ╷           ╷

                &fr_a_circM    &fr_i_tremM    &fr_i_circM     &fr_u_circM    &kp FR_SQT        &u_fr_oe      XXX          &fr_o_circM            &kp FR_UMLAUT         &u_plus_minus
     ___        &u_fr_a_grave      &fr_e_tremM    &fr_e_circM    &kp DQT          &and_pipe            &u_fr_apostrophe &u_fr_e_acute    &u_fr_e_grave          &kp FR_MU       &u_fr_u_grave  ___
     ___        &u_fr_ae           &kp FR_EURO     &u_fr_c_cedilla    &kp FR_CARET     &kp FR_BSLH          &u_fr_daqleft    &u_fr_daqright   &kp FR_QUESTION   &u_fr_ellipsis    &u_fr_tiret_quad       ___
                                            &u_fr_nobreakspace &u_fr_apostrophe ___               ___           ___           ___
        >;
    };

symbol_layer {
display-name= "SYMBOL";
//             ┏━━━━━━━━━━━━━┳━━━━━━━━━━━━━┳━━━━━━━━━━━━━┳━━━━━━━━━━━━━┳━━━━━━━━━━━━━┓   ┏━━━━━━━━━━━━━┳━━━━━━━━━━━━━┳━━━━━━━━━━━━━┳━━━━━━━━━━━━━┳━━━━━━━━━━━━━┓
//             ┃    @ µ      ┃    % -      ┃     <       ┃     >       ┃     '       ┃   ┃     "       ┃     [       ┃     ]       ┃  osm RALT   ┃             ┃
// ┏━━━━━━━━━━━╋━━━━━━━━━━━━━╋━━━━━━━━━━━━━╋━━━━━━━━━━━━━╋━━━━━━━━━━━━━╋━━━━━━━━━━━━━┫   ┣━━━━━━━━━━━━━╋━━━━━━━━━━━━━╋━━━━━━━━━━━━━╋━━━━━━━━━━━━━╋━━━━━━━━━━━━━╋━━━━━━━━━━━┓
// ┃  LSHFT    ┃     #       ┃     !       ┃     (       ┃     )       ┃     =       ┃   ┃     `       ┃  osm RCTRL  ┃  osm RSHFT  ┃  osm LALT   ┃  osm RGUI   ┃    /      ┃
// ┣━━━━━━━━━━━╋━━━━━━━━━━━━━╋━━━━━━━━━━━━━╋━━━━━━━━━━━━━╋━━━━━━━━━━━━━╋━━━━━━━━━━━━━┫   ┣━━━━━━━━━━━━━╋━━━━━━━━━━━━━╋━━━━━━━━━━━━━╋━━━━━━━━━━━━━╋━━━━━━━━━━━━━╋━━━━━━━━━━━┫
// ┃  swap     ┃     ^       ┃     &       ┃     *       ┃     \       ┃     $       ┃   ┃     '       ┃     {       ┃     }       ┃     ;       ┃             ┃  swap     ┃
// ┗━━━━━━━━━━━┻━━━━━━━━━━━━━┻━━━━━━━━━━━━━╋━━━━━━━━━━━━━╋━━━━━━━━━━━━━╋━━━━━━━━━━━━━┫   ┣━━━━━━━━━━━━━╋━━━━━━━━━━━━━╋━━━━━━━━━━━━━╋━━━━━━━━━━━━━┻━━━━━━━━━━━━━┻━━━━━━━━━━━┛
//                                         ┃    ESC      ┃    leader   ┃    TAB      ┃   ┃   ENTER     ┃   BSPC      ┃   DELETE    ┃
//                                         ┗━━━━━━━━━━━━━┻━━━━━━━━━━━━━┻━━━━━━━━━━━━━┛   ┗━━━━━━━━━━━━━┻━━━━━━━━━━━━━┻━━━━━━━━━━━━━┛
bindings = <
// ╷           ╷             ╷             ╷             ╷             ╷             ╷   ╷             ╷             ╷             ╷             ╷             ╷           ╷

                &at_mu        &pct_minus    &lt_apos      &gt_grave     &sqt_dqt          &kp FR_DQT    &kp FR_LBKT   &kp FR_RBKT   &sk RALT     XXX
     ___        &hash_tilde   &excl_sqr     &lpar_semicol &rpar_dqt     &equal_plus       &kp FR_GRAVE  &sknq RCTRL   &td_shft_capw &sk LALT     &skl RGUI       ___
     ___        &kp FR_CARET  &and_pipe     &aster_fslh   &bslh_deg     &doll_pnd         &kp FR_SQT    &kp FR_LBRC   &kp FR_RBRC   &kp FR_SEMICOLON XXX         ___
                                             ___          &leader        ___               ___           ___           ___
        >;
    };

num_layer {
display-name= "NUMBERS";
//             ┏━━━━━━━━━━━━━┳━━━━━━━━━━━━━┳━━━━━━━━━━━━━┳━━━━━━━━━━━━━┳━━━━━━━━━━━━━┓   ┏━━━━━━━━━━━━━┳━━━━━━━━━━━━━┳━━━━━━━━━━━━━┳━━━━━━━━━━━━━┳━━━━━━━━━━━━━┓
//             ┃     /       ┃     7       ┃     8       ┃     9       ┃     -       ┃   ┃             ┃             ┃             ┃             ┃             ┃
// ┏━━━━━━━━━━━╋━━━━━━━━━━━━━╋━━━━━━━━━━━━━╋━━━━━━━━━━━━━╋━━━━━━━━━━━━━╋━━━━━━━━━━━━━┫   ┣━━━━━━━━━━━━━╋━━━━━━━━━━━━━╋━━━━━━━━━━━━━╋━━━━━━━━━━━━━╋━━━━━━━━━━━━━╋━━━━━━━━━━━┓
// ┃    (      ┃     0       ┃     4       ┃     5       ┃     6       ┃     +       ┃   ┃             ┃  osm RCTRL  ┃  osm RSHFT  ┃  osm LALT   ┃   osm RGUI  ┃           ┃
// ┣━━━━━━━━━━━╋━━━━━━━━━━━━━╋━━━━━━━━━━━━━╋━━━━━━━━━━━━━╋━━━━━━━━━━━━━╋━━━━━━━━━━━━━┫   ┣━━━━━━━━━━━━━╋━━━━━━━━━━━━━╋━━━━━━━━━━━━━╋━━━━━━━━━━━━━╋━━━━━━━━━━━━━╋━━━━━━━━━━━┫
// ┃  swap     ┃     *       ┃     1       ┃     2       ┃     3       ┃     =       ┃   ┃             ┃  osm RALT   ┃             ┃             ┃             ┃  swap     ┃
// ┗━━━━━━━━━━━┻━━━━━━━━━━━━━┻━━━━━━━━━━━━━╋━━━━━━━━━━━━━╋━━━━━━━━━━━━━╋━━━━━━━━━━━━━┫   ┣━━━━━━━━━━━━━╋━━━━━━━━━━━━━╋━━━━━━━━━━━━━╋━━━━━━━━━━━━━┻━━━━━━━━━━━━━┻━━━━━━━━━━━┛
//                                         ┃    ESC      ┃    SPC      ┃    TAB      ┃   ┃   ENTER     ┃   BSPC      ┃   DELETE    ┃
//                                         ┗━━━━━━━━━━━━━┻━━━━━━━━━━━━━┻━━━━━━━━━━━━━┛   ┗━━━━━━━━━━━━━┻━━━━━━━━━━━━━┻━━━━━━━━━━━━━┛
bindings = <
// ╷           ╷             ╷             ╷             ╷             ╷             ╷   ╷             ╷             ╷             ╷             ╷             ╷           ╷

                &kp FR_SLASH  &kp FR_N7     &kp FR_N8     &kp FR_N9     &kp FR_MINUS       XXX           XXX           XXX           XXX           XXX
    &kp_l_r_par &kp FR_N0     &kp FR_N4     &kp FR_N5     &kp FR_N6     &kp FR_PLUS        XXX          &sk RCTRL     &sk RSHFT     &sk LALT      &skl RGUI       ___
     ___        &kp FR_ASTRK  &kp FR_N1     &kp FR_N2     &kp FR_N3     &kp FR_EQUAL       XXX          &sk RALT       XXX           XXX           XXX           ___
                                            &kp FR_DOT     ___           ___               ___           ___           ___
        >;
    };



navigation_layer {
display-name= "NAVIGATION";
//             ┏━━━━━━━━━━━━━┳━━━━━━━━━━━━━┳━━━━━━━━━━━━━┳━━━━━━━━━━━━━┳━━━━━━━━━━━━━┓   ┏━━━━━━━━━━━━━┳━━━━━━━━━━━━━┳━━━━━━━━━━━━━┳━━━━━━━━━━━━━┳━━━━━━━━━━━━━┓
//             ┃   ctrl+A    ┃   ctrl+X    ┃   ctrl+C    ┃   ctrl+V    ┃ vim syst cli┃   ┃   Insert    ┃    Home     ┃    End      ┃             ┃             ┃
// ┏━━━━━━━━━━━╋━━━━━━━━━━━━━╋━━━━━━━━━━━━━╋━━━━━━━━━━━━━╋━━━━━━━━━━━━━╋━━━━━━━━━━━━━┫   ┣━━━━━━━━━━━━━╋━━━━━━━━━━━━━╋━━━━━━━━━━━━━╋━━━━━━━━━━━━━╋━━━━━━━━━━━━━╋━━━━━━━━━━━┓
// ┃           ┃ osm LGUI    ┃  osm LALT   ┃  osm LSHFT  ┃  osm LCTRL  ┃   ctrl+Z    ┃   ┃ Print Screen┃    Left     ┃    Down     ┃     Up      ┃    Right    ┃  NumPad   ┃
// ┣━━━━━━━━━━━╋━━━━━━━━━━━━━╋━━━━━━━━━━━━━╋━━━━━━━━━━━━━╋━━━━━━━━━━━━━╋━━━━━━━━━━━━━┫   ┣━━━━━━━━━━━━━╋━━━━━━━━━━━━━╋━━━━━━━━━━━━━╋━━━━━━━━━━━━━╋━━━━━━━━━━━━━╋━━━━━━━━━━━┫
// ┃  swap     ┃ vim last Y  ┃  alt+F4     ┃ alt+ctrl+gui┃  osm RALT   ┃   ctrl+Y    ┃   ┃   Pause     ┃   Page Up   ┃   Page Down ┃             ┃  Context Men┃  swap     ┃
// ┗━━━━━━━━━━━┻━━━━━━━━━━━━━┻━━━━━━━━━━━━━╋━━━━━━━━━━━━━╋━━━━━━━━━━━━━╋━━━━━━━━━━━━━┫   ┣━━━━━━━━━━━━━╋━━━━━━━━━━━━━╋━━━━━━━━━━━━━╋━━━━━━━━━━━━━┻━━━━━━━━━━━━━┻━━━━━━━━━━━┛
//                                         ┃    ESC      ┃    SPC      ┃    TAB      ┃   ┃   ENTER     ┃   BSPC      ┃   DELETE    ┃
//                                         ┗━━━━━━━━━━━━━┻━━━━━━━━━━━━━┻━━━━━━━━━━━━━┛   ┗━━━━━━━━━━━━━┻━━━━━━━━━━━━━┻━━━━━━━━━━━━━┛
bindings = <
// ╷           ╷             ╷             ╷             ╷             ╷             ╷   ╷             ╷             ╷             ╷             ╷             ╷           ╷

                &kp LC(FR_A)  &kp LC(FR_X)  &kp LC(FR_C)  &kp LC(FR_V)  &vim_syst_clip    &kp INS       &kp HOME      &kp END        XXX           XXX
    ___         &skl LGUI      &sk LALT      &sk LSHFT     &sk LCTRL     &kp LC(FR_Z)      &kp PSCRN     &kp LEFT      &kp DOWN      &kp UP        &kp RIGHT     &kp KP_NUM
    &sl_togNavM &vim_last_yank &kp LA(F4)   &kp LA(LC(LGUI)) &sk RALT   &kp LC(FR_Y)      &kp PAUSE_BREAK &kp PG_UP   &kp PG_DN      XXX          &kp K_APP      &sl_togNavM
                                             ___           ___           ___               ___           ___           ___
        >;
    };

navigation_M_layer {
display-name= "NAVIGATION_M";
//             ┏━━━━━━━━━━━━━┳━━━━━━━━━━━━━┳━━━━━━━━━━━━━┳━━━━━━━━━━━━━┳━━━━━━━━━━━━━┓   ┏━━━━━━━━━━━━━┳━━━━━━━━━━━━━┳━━━━━━━━━━━━━┳━━━━━━━━━━━━━┳━━━━━━━━━━━━━┓
//             ┃             ┃             ┃    End      ┃    Home     ┃   Insert    ┃   ┃ vim syst cli┃   ctrl+V    ┃   ctrl+C    ┃   ctrl+X    ┃   ctrl+A    ┃
// ┏━━━━━━━━━━━╋━━━━━━━━━━━━━╋━━━━━━━━━━━━━╋━━━━━━━━━━━━━╋━━━━━━━━━━━━━╋━━━━━━━━━━━━━┫   ┣━━━━━━━━━━━━━╋━━━━━━━━━━━━━╋━━━━━━━━━━━━━╋━━━━━━━━━━━━━╋━━━━━━━━━━━━━╋━━━━━━━━━━━┓
// ┃           ┃    Right    ┃     Up      ┃    Down     ┃    Left     ┃ Print Screen┃   ┃   ctrl+Z    ┃  osm LCTRL  ┃  osm LSHFT  ┃  osm LALT   ┃  osm LGUI   ┃  LSHFT    ┃
// ┣━━━━━━━━━━━╋━━━━━━━━━━━━━╋━━━━━━━━━━━━━╋━━━━━━━━━━━━━╋━━━━━━━━━━━━━╋━━━━━━━━━━━━━┫   ┣━━━━━━━━━━━━━╋━━━━━━━━━━━━━╋━━━━━━━━━━━━━╋━━━━━━━━━━━━━╋━━━━━━━━━━━━━╋━━━━━━━━━━━┫
// ┃  swap     ┃ Context Men ┃             ┃   Page Down ┃   Page Up   ┃   Pause     ┃   ┃   ctrl+Y    ┃  osm RALT   ┃ alt+ctrl+gui┃  alt+F4     ┃ vim last Y  ┃  swap     ┃
// ┗━━━━━━━━━━━┻━━━━━━━━━━━━━┻━━━━━━━━━━━━━╋━━━━━━━━━━━━━╋━━━━━━━━━━━━━╋━━━━━━━━━━━━━┫   ┣━━━━━━━━━━━━━╋━━━━━━━━━━━━━╋━━━━━━━━━━━━━╋━━━━━━━━━━━━━┻━━━━━━━━━━━━━┻━━━━━━━━━━━┛
//                                         ┃   DELETE    ┃   BSPC      ┃   ENTER     ┃   ┃    TAB      ┃    SPC      ┃    ESC      ┃
//                                         ┗━━━━━━━━━━━━━┻━━━━━━━━━━━━━┻━━━━━━━━━━━━━┛   ┗━━━━━━━━━━━━━┻━━━━━━━━━━━━━┻━━━━━━━━━━━━━┛
bindings = <
// ╷           ╷             ╷             ╷             ╷             ╷             ╷   ╷             ╷             ╷             ╷             ╷             ╷           ╷

                XXX           XXX           &kp END       &kp HOME      &kp INS           &vim_syst_clip &kp LC(FR_V)  &kp LC(FR_C)  &kp LC(FR_X)  &kp LC(FR_A)
     XXX       &kp RIGHT     &kp UP        &kp DOWN      &kp LEFT      &kp PSCRN         &kp LC(FR_Z)   &sk LCTRL     &sk LSHFT     &sk LALT      &skl LGUI       ___
  &t_off NAV_M &kp K_APP      XXX           &kp PG_DN     &kp PG_UP     &kp PAUSE_BREAK   &kp LC(FR_Y)   &sk RALT      &kp LA(LC(LGUI)) &kp LA(F4) &vim_last_yank &t_off NAV_M
                                             ___           ___           ___               ___           ___           ___
        >;
};

function_layer {
display-name= "FUNCTION";
//             ┏━━━━━━━━━━━━━┳━━━━━━━━━━━━━┳━━━━━━━━━━━━━┳━━━━━━━━━━━━━┳━━━━━━━━━━━━━┓   ┏━━━━━━━━━━━━━┳━━━━━━━━━━━━━┳━━━━━━━━━━━━━┳━━━━━━━━━━━━━┳━━━━━━━━━━━━━┓
//             ┃    F12      ┃     F7      ┃     F8      ┃     F9      ┃   ScrlLock  ┃   ┃   Insert    ┃             ┃    Mute     ┃ Volume Down ┃  Volume Up  ┃
// ┏━━━━━━━━━━━╋━━━━━━━━━━━━━╋━━━━━━━━━━━━━╋━━━━━━━━━━━━━╋━━━━━━━━━━━━━╋━━━━━━━━━━━━━┫   ┣━━━━━━━━━━━━━╋━━━━━━━━━━━━━╋━━━━━━━━━━━━━╋━━━━━━━━━━━━━╋━━━━━━━━━━━━━╋━━━━━━━━━━━┓
// ┃  LSHFT    ┃    F11      ┃     F4      ┃     F5      ┃     F6      ┃ PrintScreen ┃   ┃   NumPad    ┃   R Ctrl    ┃   R Shift   ┃   L Alt     ┃   R Gui     ┃    /      ┃
// ┣━━━━━━━━━━━╋━━━━━━━━━━━━━╋━━━━━━━━━━━━━╋━━━━━━━━━━━━━╋━━━━━━━━━━━━━╋━━━━━━━━━━━━━┫   ┣━━━━━━━━━━━━━╋━━━━━━━━━━━━━╋━━━━━━━━━━━━━╋━━━━━━━━━━━━━╋━━━━━━━━━━━━━╋━━━━━━━━━━━┫
// ┃  swap     ┃    F10      ┃     F1      ┃     F2      ┃     F3      ┃   Pause     ┃   ┃             ┃   R Alt     ┃ Media Prev  ┃ Media Play  ┃ Media Next  ┃  swap     ┃
// ┗━━━━━━━━━━━┻━━━━━━━━━━━━━┻━━━━━━━━━━━━━╋━━━━━━━━━━━━━╋━━━━━━━━━━━━━╋━━━━━━━━━━━━━┫   ┣━━━━━━━━━━━━━╋━━━━━━━━━━━━━╋━━━━━━━━━━━━━╋━━━━━━━━━━━━━┻━━━━━━━━━━━━━┻━━━━━━━━━━━┛
//                                         ┃    ESC      ┃    SPC      ┃    TAB      ┃   ┃   ENTER     ┃   BSPC      ┃   DELETE    ┃
//                                         ┗━━━━━━━━━━━━━┻━━━━━━━━━━━━━┻━━━━━━━━━━━━━┛   ┗━━━━━━━━━━━━━┻━━━━━━━━━━━━━┻━━━━━━━━━━━━━┛
bindings = <

// ╷           ╷             ╷             ╷             ╷             ╷             ╷   ╷             ╷             ╷             ╷             ╷             ╷           ╷

                &kp F12       &kp F7        &kp F8        &kp F9        &kp SLCK          &kp INS        XXX          &kp C_MUTE    &kp C_VOL_DN  &kp C_VOL_UP
     ___        &kp F11       &kp F4        &kp F5        &kp F6        &kp PSCRN         &kp KP_NUM    &kp RCTRL     &kp RSHIFT    &kp LALT      &kp LGUI       XXX
     ___        &kp F10       &kp F1        &kp F2        &kp F3        &kp PAUSE_BREAK    XXX          &kp RALT      &kp C_PREV    &kp C_PLAY_PAUSE &kp C_NEXT  ___
                                             ___           ___           ___               ___           ___           ___
                        >;
                };

app_layer {
display-name= "APPS";
//             ┏━━━━━━━━━━━━━┳━━━━━━━━━━━━━┳━━━━━━━━━━━━━┳━━━━━━━━━━━━━┳━━━━━━━━━━━━━┓   ┏━━━━━━━━━━━━━┳━━━━━━━━━━━━━┳━━━━━━━━━━━━━┳━━━━━━━━━━━━━┳━━━━━━━━━━━━━┓
//             ┃  BT Sel 0   ┃ BT Sel 1    ┃ BT Sel 2    ┃ BT Sel 3    ┃ BT Clear    ┃   ┃   td_reset  ┃   Alt+L     ┃   Ctrl+²    ┃             ┃ mouse_reset ┃
// ┏━━━━━━━━━━━╋━━━━━━━━━━━━━╋━━━━━━━━━━━━━╋━━━━━━━━━━━━━╋━━━━━━━━━━━━━╋━━━━━━━━━━━━━┫   ┣━━━━━━━━━━━━━╋━━━━━━━━━━━━━╋━━━━━━━━━━━━━╋━━━━━━━━━━━━━╋━━━━━━━━━━━━━╋━━━━━━━━━━━┓
// ┃ reset_boot┃   LGUI      ┃    LALT     ┃   LSHIFT    ┃   LCTRL     ┃             ┃   ┃ Context Menu┃   browser   ┃             ┃ Sh+Alt+Ctl+T┃             ┃    /      ┃
// ┣━━━━━━━━━━━╋━━━━━━━━━━━━━╋━━━━━━━━━━━━━╋━━━━━━━━━━━━━╋━━━━━━━━━━━━━╋━━━━━━━━━━━━━┫   ┣━━━━━━━━━━━━━╋━━━━━━━━━━━━━╋━━━━━━━━━━━━━╋━━━━━━━━━━━━━╋━━━━━━━━━━━━━╋━━━━━━━━━━━┫
// ┃  swap     ┃  out USB    ┃ out BLE     ┃   ind_bat   ┃   RALT      ┃ ind_con     ┃   ┃ Sh+Alt+Ctl+K┃  Ctrl+Alt+F ┃   Calc      ┃ Sh+Gui+S    ┃             ┃  swap     ┃
// ┗━━━━━━━━━━━┻━━━━━━━━━━━━━┻━━━━━━━━━━━━━╋━━━━━━━━━━━━━╋━━━━━━━━━━━━━╋━━━━━━━━━━━━━┫   ┣━━━━━━━━━━━━━╋━━━━━━━━━━━━━╋━━━━━━━━━━━━━╋━━━━━━━━━━━━━┻━━━━━━━━━━━━━┻━━━━━━━━━━━┛
//                                         ┃    ESC      ┃    SPC      ┃    TAB      ┃   ┃   ENTER     ┃   BSPC      ┃   DELETE    ┃
//                                         ┗━━━━━━━━━━━━━┻━━━━━━━━━━━━━┻━━━━━━━━━━━━━┛   ┗━━━━━━━━━━━━━┻━━━━━━━━━━━━━┻━━━━━━━━━━━━━┛
bindings = <

// ╷           ╷             ╷             ╷             ╷             ╷             ╷   ╷             ╷             ╷             ╷             ╷             ╷           ╷

                &bt BT_SEL 0  &bt BT_SEL 1  &bt BT_SEL 2  &bt BT_SEL 3  &bt BT_CLR        &td_reset     &kp LA(L)     &kp LC(FR_SQUARE)  XXX       &mouse_reset
&reset_bootloader &kp LGUI    &kp LALT      &kp LSHIFT    &kp LCTRL     XXX               &kp K_APP     &kp C_AC_HOME XXX          &kp LS(LA(LC(T)))  XXX           ___
     ___        &out OUT_USB  &out OUT_BLE  &ind_bat      &kp RALT      &ind_con          &kp LS(LA(LC(K))) &kp LC(LA(F)) &kp C_AL_CALC &kp LG(LS(S)) XXX           ___
                                             ___           ___           ___               ___           ___           ___
                        >;
                };

excel_layer {
display-name= "EXCEL";
//             ┏━━━━━━━━━━━━━┳━━━━━━━━━━━━━┳━━━━━━━━━━━━━┳━━━━━━━━━━━━━┳━━━━━━━━━━━━━┓   ┏━━━━━━━━━━━━━┳━━━━━━━━━━━━━┳━━━━━━━━━━━━━┳━━━━━━━━━━━━━┳━━━━━━━━━━━━━┓
//             ┃    Left     ┃   Down      ┃     Up      ┃    Right    ┃     F2      ┃   ┃     /       ┃     7       ┃     8       ┃     9       ┃     -       ┃
// ┏━━━━━━━━━━━╋━━━━━━━━━━━━━╋━━━━━━━━━━━━━╋━━━━━━━━━━━━━╋━━━━━━━━━━━━━╋━━━━━━━━━━━━━┫   ┣━━━━━━━━━━━━━╋━━━━━━━━━━━━━╋━━━━━━━━━━━━━╋━━━━━━━━━━━━━╋━━━━━━━━━━━━━╋━━━━━━━━━━━┓
// ┃  LSHFT    ┃  osm LGUI   ┃  osm LALT   ┃  osm LSHIFT ┃   osm LCTRL ┃   Shift+G   ┃   ┃     0       ┃     4       ┃     5       ┃     6       ┃     +       ┃  NumPad   ┃
// ┣━━━━━━━━━━━╋━━━━━━━━━━━━━╋━━━━━━━━━━━━━╋━━━━━━━━━━━━━╋━━━━━━━━━━━━━╋━━━━━━━━━━━━━┫   ┣━━━━━━━━━━━━━╋━━━━━━━━━━━━━╋━━━━━━━━━━━━━╋━━━━━━━━━━━━━╋━━━━━━━━━━━━━╋━━━━━━━━━━━┫
// ┃  swap     ┃             ┃   Cut       ┃    Copy     ┃  osm RALT   ┃   Paste     ┃   ┃     *       ┃     1       ┃     2       ┃     3       ┃     .       ┃  swap     ┃
// ┗━━━━━━━━━━━┻━━━━━━━━━━━━━┻━━━━━━━━━━━━━╋━━━━━━━━━━━━━╋━━━━━━━━━━━━━╋━━━━━━━━━━━━━┫   ┣━━━━━━━━━━━━━╋━━━━━━━━━━━━━╋━━━━━━━━━━━━━╋━━━━━━━━━━━━━┻━━━━━━━━━━━━━┻━━━━━━━━━━━┛
//                                         ┃    ESC      ┃    SPC      ┃    TAB      ┃   ┃   ENTER     ┃   BSPC      ┃   DELETE    ┃
//                                         ┗━━━━━━━━━━━━━┻━━━━━━━━━━━━━┻━━━━━━━━━━━━━┛   ┗━━━━━━━━━━━━━┻━━━━━━━━━━━━━┻━━━━━━━━━━━━━┛
bindings = <

// ╷           ╷             ╷             ╷             ╷             ╷             ╷   ╷             ╷             ╷             ╷             ╷             ╷           ╷

                &kp LEFT      &kp DOWN      &kp UP        &kp RIGHT     &kp F2            &kp KP_SLASH  &kp KP_N7     &kp KP_N8     &kp KP_N9     &kp KP_MINUS
     ___        &skl LGUI     &sk LALT      &sk LSHFT     &sknq LCTRL   &kp LS(G)         &kp KP_N0     &kp KP_N4     &kp KP_N5     &kp KP_N6     &kp KP_PLUS    &kp KP_NUM
     ___        XXX           &kp LC(FR_X)  &kp LC(FR_C)  &kp RALT      &kp LC(FR_V)      &kp KP_ASTERISK &kp KP_N1   &kp KP_N2     &kp KP_N3     &kp KP_DOT     ___
                                             ___           ___           ___               ___           ___           ___
                        >;
                };

snake_layer {
display-name= "SNAKE";
bindings = <
// ╷           ╷             ╷             ╷             ╷             ╷             ╷   ╷             ╷             ╷             ╷             ╷             ╷           ╷
                 ___           ___           ___           ___           ___               ___         ___           ___           XXX           ___
     ___         ___           ___           ___           ___           ___               ___         ___           ___           ___           ___           ___
     ___         ___           ___           ___           ___           ___               ___         ___           ___           ___           ___           ___
                                             ___           &ak_snake     &mo EXCEL         ___         ___           ___
                        >;
                };

camel_layer {
display-name= "CAMEL";
bindings = <
// ╷           ╷             ╷             ╷             ╷             ╷             ╷   ╷             ╷             ╷             ╷             ╷             ╷           ╷
                 ___           ___           ___           ___           ___               ___         ___           ___           XXX           ___
     ___         ___           ___           ___           ___           ___               ___         ___           ___           ___           ___           ___
     ___         ___           ___           ___           ___           ___               ___         ___           ___           ___           ___           ___
                                             ___           &ak_camel     ___               ___         ___           ___
                        >;
                };

kebab_layer {
display-name= "KEBAB";
bindings = <
// ╷           ╷             ╷             ╷             ╷             ╷             ╷   ╷             ╷             ╷             ╷             ╷             ╷           ╷
                 ___           ___           ___           ___           ___               ___         ___           ___           XXX           ___
     ___         ___           ___           ___           ___           ___               ___         ___           ___           ___           ___           ___
     ___         ___           ___           ___           ___           ___               ___         ___           ___           ___           ___           ___
                                             ___           &ak_kebab     &mo EXCEL         ___         ___           ___
                        >;
                };

path_layer {
display-name= "PATH_CASE";
bindings = <
// ╷           ╷             ╷             ╷             ╷             ╷             ╷   ╷             ╷             ╷             ╷             ╷             ╷           ╷
                 ___           ___           ___           ___           ___               ___         ___           ___           XXX           ___
     ___         ___           ___           ___           ___           ___               ___         ___           ___           ___           ___           ___
     ___         ___           ___           ___           ___           ___               ___         ___           ___           ___           ___           ___
                                             ___           &ak_bslh      &mo EXCEL         ___         ___           ___
                        >;
                };
slsh_layer {
display-name= "SLSH_CASE";
bindings = <
// ╷           ╷             ╷             ╷             ╷             ╷             ╷   ╷             ╷             ╷             ╷             ╷             ╷           ╷
                 ___           ___           ___           ___           ___               ___         ___           ___           XXX           ___
     ___         ___           ___           ___           ___           ___               ___         ___           ___           ___           ___           ___
     ___         ___           ___           ___           ___           ___               ___         ___           ___           ___           ___           ___
                                             ___           &ak_slash     &mo EXCEL         ___         ___           ___
                        >;
                };

num_temp_layer {
    display-name= "NUMS_TMP";
    bindings = <
                 ___           ___           ___           ___           ___               ___         ___           ___           ___           ___
     ___         ___           ___           ___           ___           ___               ___         ___           ___           ___           ___           ___
     ___         ___           ___           ___           ___           ___               ___         ___           ___           ___           ___           ___
                                             ___           ___           ___               ___         ___           ___
        >;
    };
num_lock_layer {
    display-name= "NUMS_LOCK";
    bindings = <
                 ___           ___           ___           ___           ___               ___         ___           ___           ___           ___
     ___         ___           ___           ___           ___           ___               ___         ___           ___           ___           ___           ___
     ___         ___           ___           ___           ___           ___               ___         ___           ___           ___           ___           ___
                                             ___           ___           ___               ___         ___           ___
        >;
    };
nav_temp_layer {
    display-name= "NAV_TMP";
    bindings = <
                 ___           ___           ___           ___           ___               ___         ___           ___           ___           ___
     ___         ___           ___           ___           ___           ___               ___         ___           ___           ___           ___           ___
     ___         ___           ___           ___           ___           ___               ___         ___           ___           ___           ___           ___
                                             ___           ___           ___               ___         ___           ___
        >;
    };

nav_lock_layer {
    display-name= "NAV_LOCK";
    bindings = <
                 ___           ___           ___           ___           ___               ___         ___           ___           ___           ___
     ___         ___           ___           ___           ___           ___               ___         ___           ___           ___           ___           ___
     ___         ___           ___           ___           ___           ___               ___         ___           ___           ___           ___           ___
                                             ___           ___           ___               ___         ___           ___
        >;
    };
nav_m_temp_layer {
    display-name= "NAV_M_TMP";
    bindings = <
                 ___           ___           ___           ___           ___               ___         ___           ___           ___           ___
     ___         ___           ___           ___           ___           ___               ___         ___           ___           ___           ___           ___
     ___         ___           ___           ___           ___           ___               ___         ___           ___           ___           ___           ___
                                             ___           ___           ___               ___         ___           ___
        >;
    };

nav_m_lock_layer {
    display-name= "NAV_M_LOCK";
    bindings = <
                 ___           ___           ___           ___           ___               ___         ___           ___           ___           ___
     ___         ___           ___           ___           ___           ___               ___         ___           ___           ___           ___           ___
     ___         ___           ___           ___           ___           ___               ___         ___           ___           ___           ___           ___
                                             ___           ___           ___               ___         ___           ___
        >;
    };

excel_temp_layer {
    display-name= "EXCEL_TMP";
    bindings = <
                 ___           ___           ___           ___           ___               ___         ___           ___           ___           ___
     ___         ___           ___           ___           ___           ___               ___         ___           ___           ___           ___           ___
     ___         ___           ___           ___           ___           ___               ___         ___           ___           ___           ___           ___
                                             ___           ___           ___               ___         ___           ___
        >;
    };

excel_lock_layer {
    display-name= "EXCEL_LOCK";
    bindings = <
                 ___           ___           ___           ___           ___               ___         ___           ___           ___           ___
     ___         ___           ___           ___           ___           ___               ___         ___           ___           ___           ___           ___
     ___         ___           ___           ___           ___           ___               ___         ___           ___           ___           ___           ___
                                             ___           ___           ___               ___         ___           ___
        >;
    };

mouse_layer {
display-name= "MOUSE";
//             ┏━━━━━━━━━━━━━┳━━━━━━━━━━━━━┳━━━━━━━━━━━━━┳━━━━━━━━━━━━━┳━━━━━━━━━━━━━┓   ┏━━━━━━━━━━━━━┳━━━━━━━━━━━━━┳━━━━━━━━━━━━━┳━━━━━━━━━━━━━┳━━━━━━━━━━━━━┓
//             ┃             ┃    Cut      ┃    Copy     ┃    Paste    ┃             ┃   ┃  Mouse Btn4 ┃  Wheel Up   ┃ Mouse Up    ┃  Wheel Down ┃             ┃
// ┏━━━━━━━━━━━╋━━━━━━━━━━━━━╋━━━━━━━━━━━━━╋━━━━━━━━━━━━━╋━━━━━━━━━━━━━╋━━━━━━━━━━━━━┫   ┣━━━━━━━━━━━━━╋━━━━━━━━━━━━━╋━━━━━━━━━━━━━╋━━━━━━━━━━━━━╋━━━━━━━━━━━━━╋━━━━━━━━━━━┓
// ┃  LSHFT    ┃  osm LGUI   ┃  osm LALT   ┃  osm LSHIFT ┃   osm LCTRL ┃    ESC      ┃   ┃  Mouse Btn 5┃  Mouse Left ┃  Mouse Down ┃  Mouse Right┃             ┃    /      ┃
// ┣━━━━━━━━━━━╋━━━━━━━━━━━━━╋━━━━━━━━━━━━━╋━━━━━━━━━━━━━╋━━━━━━━━━━━━━╋━━━━━━━━━━━━━┫   ┣━━━━━━━━━━━━━╋━━━━━━━━━━━━━╋━━━━━━━━━━━━━╋━━━━━━━━━━━━━╋━━━━━━━━━━━━━╋━━━━━━━━━━━┫
// ┃  swap     ┃             ┃     RALT    ┃             ┃             ┃             ┃   ┃             ┃ Wheel Left  ┃             ┃ Wheel Right ┃             ┃  swap     ┃
// ┗━━━━━━━━━━━┻━━━━━━━━━━━━━┻━━━━━━━━━━━━━╋━━━━━━━━━━━━━╋━━━━━━━━━━━━━╋━━━━━━━━━━━━━┫   ┣━━━━━━━━━━━━━╋━━━━━━━━━━━━━╋━━━━━━━━━━━━━╋━━━━━━━━━━━━━┻━━━━━━━━━━━━━┻━━━━━━━━━━━┛
//                                         ┃   ___       ┃    ___      ┃     ___     ┃   ┃ Mouse Btn L ┃ Mouse Btn M ┃ Mouse Btn R ┃
//                                         ┗━━━━━━━━━━━━━┻━━━━━━━━━━━━━┻━━━━━━━━━━━━━┛   ┗━━━━━━━━━━━━━┻━━━━━━━━━━━━━┻━━━━━━━━━━━━━┛
bindings = <
// ╷           ╷             ╷             ╷             ╷             ╷             ╷   ╷             ╷             ╷             ╷             ╷             ╷           ╷
                 XXX          &kp LC(FR_X)  &kp LC(FR_C)  &kp LC(FR_V)   XXX              &mkp MB4      &msc SCRL_UP  &mmv MOVE_UP  &msc SCRL_DOWN  XXX
     ___        &skl LGUI      &sk LALT      &sk LSHFT     &sk LCTRL     &kp ESC          &mkp MB5       &mmv MOVE_LEFT &mmv MOVE_DOWN &mmv MOVE_RIGHT  XXX       ___
     ___         XXX          &kp RALT      XXX           XXX           XXX                XXX          &msc SCRL_LEFT  XXX          &msc SCRL_RIGHT  XXX        ___
                                            &kp DEL       &kp BSPC      &kp RET           &mkp LCLK     &mkp MCLK     &mkp RCLK
                        >;
                };

mouse_tp_layer {
display-name= "MOUSE_TP";
//             ┏━━━━━━━━━━━━━┳━━━━━━━━━━━━━┳━━━━━━━━━━━━━┳━━━━━━━━━━━━━┳━━━━━━━━━━━━━┓   ┏━━━━━━━━━━━━━┳━━━━━━━━━━━━━┳━━━━━━━━━━━━━┳━━━━━━━━━━━━━┳━━━━━━━━━━━━━┓
//             ┃             ┃    Cut      ┃    Copy     ┃    Paste    ┃             ┃   ┃             ┃             ┃ NegInert up ┃ speed up    ┃ sensitive up┃
// ┏━━━━━━━━━━━╋━━━━━━━━━━━━━╋━━━━━━━━━━━━━╋━━━━━━━━━━━━━╋━━━━━━━━━━━━━╋━━━━━━━━━━━━━┫   ┣━━━━━━━━━━━━━╋━━━━━━━━━━━━━╋━━━━━━━━━━━━━╋━━━━━━━━━━━━━╋━━━━━━━━━━━━━╋━━━━━━━━━━━┓
// ┃  LSHFT    ┃  osm LGUI   ┃  osm LALT   ┃  osm LSHIFT ┃   osm LCTRL ┃    ESC      ┃   ┃             ┃             ┃ NegInert Dow┃ speed down  ┃ sensit. down┃    /      ┃
// ┣━━━━━━━━━━━╋━━━━━━━━━━━━━╋━━━━━━━━━━━━━╋━━━━━━━━━━━━━╋━━━━━━━━━━━━━╋━━━━━━━━━━━━━┫   ┣━━━━━━━━━━━━━╋━━━━━━━━━━━━━╋━━━━━━━━━━━━━╋━━━━━━━━━━━━━╋━━━━━━━━━━━━━╋━━━━━━━━━━━┫
// ┃  swap     ┃             ┃     RALT    ┃ scroll layer┃ Mouse Btn 4 ┃ Mouse Btn 5 ┃   ┃             ┃             ┃             ┃  ms_log     ┃  ms_reset   ┃  swap     ┃
// ┗━━━━━━━━━━━┻━━━━━━━━━━━━━┻━━━━━━━━━━━━━╋━━━━━━━━━━━━━╋━━━━━━━━━━━━━╋━━━━━━━━━━━━━┫   ┣━━━━━━━━━━━━━╋━━━━━━━━━━━━━╋━━━━━━━━━━━━━╋━━━━━━━━━━━━━┻━━━━━━━━━━━━━┻━━━━━━━━━━━┛
//                                         ┃ Mouse Btn L ┃ Mouse Btn M ┃ Mouse Btn R ┃   ┃ Mouse Btn L ┃ Mouse Btn M ┃ Mouse Btn R ┃
//                                         ┗━━━━━━━━━━━━━┻━━━━━━━━━━━━━┻━━━━━━━━━━━━━┛   ┗━━━━━━━━━━━━━┻━━━━━━━━━━━━━┻━━━━━━━━━━━━━┛
bindings = <
// ╷           ╷             ╷             ╷             ╷             ╷             ╷   ╷             ╷             ╷             ╷             ╷             ╷           ╷
                 XXX          &kp LC(FR_X)  &kp LC(FR_C)  &kp LC(FR_V)   XXX               XXX          XXX          U_MSS_TP_NI_I  U_MSS_TP_V6_I  U_MSS_TP_S_I
     ___        &skl LGUI      &sk LALT      &sk LSHFT     &sk LCTRL     &kp ESC            XXX         XXX          U_MSS_TP_NI_D  U_MSS_TP_V6_D  U_MSS_TP_S_D  ___
     ___         XXX          &kp RALT      &mo MOUSE_SCR &mkp MB4      &mkp MB5           XXX          XXX          XXX            U_MSS_LOG      U_MSS_RESET   ___
                                            &mkp LCLK     &mkp MCLK     &mkp RCLK         &mkp LCLK     &mkp MCLK     &mkp RCLK
                        >;
                };

mouse_layer_scroll {
display-name= "MOUSE_SCR";
//             ┏━━━━━━━━━━━━━┳━━━━━━━━━━━━━┳━━━━━━━━━━━━━┳━━━━━━━━━━━━━┳━━━━━━━━━━━━━┓   ┏━━━━━━━━━━━━━┳━━━━━━━━━━━━━┳━━━━━━━━━━━━━┳━━━━━━━━━━━━━┳━━━━━━━━━━━━━┓
//             ┃             ┃    Cut      ┃    Copy     ┃    Paste    ┃             ┃   ┃             ┃  Wheel Up   ┃ Mouse Up    ┃  Wheel Down ┃             ┃
// ┏━━━━━━━━━━━╋━━━━━━━━━━━━━╋━━━━━━━━━━━━━╋━━━━━━━━━━━━━╋━━━━━━━━━━━━━╋━━━━━━━━━━━━━┫   ┣━━━━━━━━━━━━━╋━━━━━━━━━━━━━╋━━━━━━━━━━━━━╋━━━━━━━━━━━━━╋━━━━━━━━━━━━━╋━━━━━━━━━━━┓
// ┃  LSHFT    ┃  osm LGUI   ┃  osm LALT   ┃  osm LSHIFT ┃   osm LCTRL ┃    ESC      ┃   ┃             ┃  Mouse Left ┃  Mouse Down ┃  Mouse Right┃             ┃    /      ┃
// ┣━━━━━━━━━━━╋━━━━━━━━━━━━━╋━━━━━━━━━━━━━╋━━━━━━━━━━━━━╋━━━━━━━━━━━━━╋━━━━━━━━━━━━━┫   ┣━━━━━━━━━━━━━╋━━━━━━━━━━━━━╋━━━━━━━━━━━━━╋━━━━━━━━━━━━━╋━━━━━━━━━━━━━╋━━━━━━━━━━━┫
// ┃  swap     ┃             ┃     RALT    ┃             ┃ Mouse Btn 4 ┃ Mouse Btn 5 ┃   ┃             ┃ Wheel Left  ┃             ┃ Wheel Right ┃             ┃  swap     ┃
// ┗━━━━━━━━━━━┻━━━━━━━━━━━━━┻━━━━━━━━━━━━━╋━━━━━━━━━━━━━╋━━━━━━━━━━━━━╋━━━━━━━━━━━━━┫   ┣━━━━━━━━━━━━━╋━━━━━━━━━━━━━╋━━━━━━━━━━━━━╋━━━━━━━━━━━━━┻━━━━━━━━━━━━━┻━━━━━━━━━━━┛
//                                         ┃ Mouse Btn L ┃ Mouse Btn M ┃ Mouse Btn R ┃   ┃ Mouse Btn L ┃ Mouse Btn M ┃ Mouse Btn R ┃
//                                         ┗━━━━━━━━━━━━━┻━━━━━━━━━━━━━┻━━━━━━━━━━━━━┛   ┗━━━━━━━━━━━━━┻━━━━━━━━━━━━━┻━━━━━━━━━━━━━┛
bindings = <
// ╷           ╷             ╷             ╷             ╷             ╷             ╷   ╷             ╷             ╷             ╷             ╷             ╷           ╷
                 ___           ___           ___           ___           XXX               XXX         ___           ___           ___            XXX
     ___         ___           ___           ___           ___           ___               ___         ___           ___           ___           ___           ___
     ___         ___           ___           ___           ___           ___               ___         ___           ___           ___           ___           ___
                                             ___           ___           ___               ___         ___           ___
                        >;
                };

       };

};
