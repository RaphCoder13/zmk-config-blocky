## config/west.yml
```yaml
manifest:
  remotes:
    - name: zmkfirmware
      url-base: https://github.com/zmkfirmware
    # Additional modules containing boards/shields/custom code can be listed here as well
    # See https://docs.zephyrproject.org/3.2.0/develop/west/manifest.html#projects
    - name: infused-kim
      url-base: https://github.com/infused-kim
    - name: petejohanson
      url-base: https://github.com/petejohanson
    - name: urob
      url-base: https://github.com/urob
    - name: badjeff
      url-base: https://github.com/badjeff
    - name: raphcoder13
      url-base: https://github.com/RaphCoder13
    - name: caksoylar
      url-base: https://github.com/caksoylar
    - name: joelspadin
      url-base: https://github.com/joelspadin
    - name: zzeneg
      url-base: https://github.com/zzeneg
  projects:
    - name: zmk
      remote: zmkfirmware
      revision: main
      import: app/west.yml

    # - name: zmk
    #   remote: infused-kim
    #   revision: pr-testing/mouse_ps2_module_base
    #   import: app/west.yml
    # - name: blocky-zmk-module
    - name: zephyr
      remote: urob
      revision: v3.5.0+zmk-fixes
      clone-depth: 1
      import:
        name-blocklist:
          - ci-tools
          - hal_altera
          - hal_cypress
          - hal_infineon
          - hal_microchip
          - hal_nxp
          - hal_openisa
          - hal_silabs
          - hal_xtensa
          - hal_st
          - hal_ti
          - loramac-node
          - mcuboot
          - mcumgr
          - net-tools
          - openthread
          - edtt
          - trusted-firmware-m
    - name: kb_zmk_ps2_mouse_trackpoint_driver
      remote: badjeff
      revision: main
    - name: zmk-locales
      remote: joelspadin
      revision: main
    - name: zmk-rgbled-widget
      remote: caksoylar
      revision: main
    - name: zmk-keyboard-blocky
      remote: raphcoder13
      revision: main
    - name: zmk-helpers
      remote: urob
      revision: main
    - name: zmk-leader-key
      remote: urob
      revision: main
    - name: zmk-adaptive-key
      remote: urob
      revision: v0.2
    - name: zmk-auto-layer
      remote: urob
      revision: main
    - name: zmk-tri-state
      remote: urob
      revision: main
    - name: zmk-raw-hid
      remote: zzeneg
      revision: main
    - name: zmk-kblayerhelper
      remote: raphcoder13
      revision: main
self:
    path: config
```
