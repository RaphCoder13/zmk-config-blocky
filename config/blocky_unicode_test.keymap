//
//                                                                      ▀  ▀  ▀
//
// ▄▄▄▄▄▄▄▄▄▄▄▄▄▄▄▄▄▄▄▄▄▄▄▄▄▄▄▄▄▄▄▄▄▄▄▄▄▄▄▄▄▄▄▄▄▄▄▄▄▄▄▄▄▄▄▄▄▄▄▄▄▄▄▄▄▄▄▄▄▄▄▄▄▄▄▄▄▄▄▄▄▄▄▄▄▄▄▄▄▄▄▄▄▄▄▄▄▄▄▄▄▄▄▄▄▄▄▄▄▄▄▄▄▄▄▄▄▄▄▄▄▄▄▄▄▄▄▄▄▄▄▄▄▄▄▄▄▄▄▄▄▄▄▄▄▄▄▄▄


#define HOST_OS 2

#include <behaviors.dtsi>
#include <dt-bindings/zmk/keys.h>
#include <dt-bindings/zmk/bt.h>
#include <dt-bindings/zmk/outputs.h>
#include <zmk-helpers/helper.h>
// #include "zmk-helpers/key-labels/blocky_keys.h"
#include "blocky_keys.h"
#include <locale/keys_fr.h>
#include <behaviors/rgbled_widget.dtsi>
#include <behaviors/num_word.dtsi>


#define XXX &none
#define ___ &trans

#define BASE 0
#define BASE_M 1
#define ACCENT 2
#define SYM 3
#define NUMS 4
#define NAV 5
#define NAV_M 6
#define FUNCTION_L 7
#define APPS 8
#define MOUSE_TP 9
#define MOUSE_SCR 10
#define EXCEL 11
#define SNAKE 12
#define CAMEL 13
#define KEBAB 14
#define PATH_CASE 15
#define SLSH_CASE 16


#define HAS_MOUSE_KEYS
// #define HAS_MOUSE_TP

#ifdef HAS_MOUSE_KEYS
  #include <dt-bindings/zmk/mouse.h>
  #include <behaviors/mouse_keys.dtsi>
#endif  // HAS_MOUSE_KEYS

// #ifdef HAS_MOUSE_TP
//   // We store the trackpoint settings in a separate file
//   // to make organization a little easier.
//   #include "include/mouse_tp.dtsi"
// #endif  // HAS_MOUSE_TP

#define STICKY_TOGGLE(name, layer)           \
  sl_tog##name: sticky_layer_toggle##name {  \
    compatible = "zmk,behavior-tap-dance";   \
    #binding-cells = <0>;                    \
    bindings = <&sl layer>, <&tog layer>;    \
  }

#undef ZMK_LEADER_SEQUENCE
#define ZMK_LEADER_SEQUENCE(name, leader_bindings, leader_sequence) \
    / { \
        behaviors { \
            leader: leader { \
                compatible = "zmk,behavior-leader-key"; \
                #binding-cells = <0>; \
                ignore-keys = <LSHFT RSHFT>; \
                leader_sequence_ ## name { \
                    bindings = <leader_bindings>; \
                    sequence = <leader_sequence>; \
                }; \
            }; \
        }; \
    };

// #ifdef HAS_MOUSE_TP
#include <zephyr/dt-bindings/input/input-event-codes.h>

/ {
    zip_temp_layer: zip_temp_layer {
        compatible = "zmk,input-processor-temp-layer";
        #input-processor-cells = <2>;
        require-prior-idle-ms = <1000>;
    };
};
&trackpoint_listener {
    input-processors = <&zip_xy_transform (INPUT_TRANSFORM_Y_INVERT)>,<&zip_temp_layer MOUSE_TP 1000 >;
    // input-processors = <&zip_xy_transform (INPUT_TRANSFORM_Y_INVERT)>,<&zip_xy_transform (INPUT_TRANSFORM_X_INVERT)>,<&zip_temp_layer MOUSE_TP 1000>;
    scroller {
        layers = <MOUSE_SCR>;
        input-processors = <&zip_xy_to_scroll_mapper>;
    };
};
// #endif
#undef COMBO_TERM
#define COMBO_TERM 60

&caps_word {
    continue-list = <FR_UNDER DEL BSPC FR_M>;
};

&sk {
    quick-release;
};

/ {
    behaviors {
        skl: sticky_key_lazy {
            compatible = "zmk,behavior-sticky-key";
            #binding-cells = <1>;
            bindings = <&kp>;
            release-after-ms = <1000>;
            lazy;
            quick-release;
            ignore-modifiers;
        };
    };
};

&mt {
  quick-tap-ms = <100>;
  // global-quick-tap;
  flavor = "tap-preferred";
  tapping-term-ms = <170>;
};


    // Timeless homerow mods
    #define KEYS_L LT0 LT1 LT2 LT3 LT4 LM0 LM1 LM2 LM3 LM4 LM5 LB0 LB1 LB2 LB3 LB4 LB5
    #define KEYS_R RT0 RT1 RT2 RT3 RT4 RM0 RM1 RM2 RM3 RM4 RM5 RB0 RB1 RB2 RB3 RB4 RB5
    #define THUMBS LH0 LH1 LH2 RH0 RH1 RH2


    ZMK_HOLD_TAP(hml,
        flavor = "balanced";
        tapping-term-ms = <280>;
        require-prior-idle-ms = <150>;
        hold-trigger-key-positions = <KEYS_R THUMBS>;
        hold-trigger-on-release;
        bindings = <&kp>, <&kp>;
    )

    ZMK_HOLD_TAP(hmr,
        flavor = "balanced";
        tapping-term-ms = <280>;
        require-prior-idle-ms = <150>;
        hold-trigger-key-positions = <KEYS_L THUMBS>;
        hold-trigger-on-release;
        bindings = <&kp>, <&kp>;
    )

    // Base layer
    ZMK_MOD_MORPH(minus_slash, bindings = <&kp FR_MINUS>, <&kp FR_SLASH>; mods = <(MOD_LSFT|MOD_RSFT)>;)
    ZMK_MOD_MORPH(comma_semi, bindings = <&kp FR_COMMA>, <&kp FR_SEMICOLON>; mods = <(MOD_LSFT|MOD_RSFT)>;)
    ZMK_MOD_MORPH(dot_colon, bindings = <&kp FR_DOT>, <&kp FR_COLON>; mods = <(MOD_LSFT|MOD_RSFT)>;)
    ZMK_MOD_MORPH(under_qmark, bindings = <&kp FR_UNDERSCORE>, <&kp FR_QUESTION>; mods = <(MOD_LSFT|MOD_RSFT)>;)
    // Test pour caps_word pour FR_M
    // ZMK_MOD_MORPH(m_supM, bindings = <&kp FR_M>, <&kp FR_M>; mods = <(MOD_LSFT|MOD_RSFT)>; )


    // ZMK_UNICODE_PAIR(fr_ae,             N0, N0, E, N6,   N0, N0, C, N6)  // æ/Æ
    // ZMK_UNICODE_PAIR(fr_oe,             N0, N1, N5, N3,  N0, N1, N5, N2) // œ/Œ
    // ZMK_UNICODE_PAIR(fr_a_grave,        N0, N0, E, N0,   N0, N0, C, N0)  // à/À
    // ZMK_UNICODE_PAIR(fr_a_circumflex,   N0, N0, E, N2,   N0, N0, C, N2)  // â/Â
    // ZMK_UNICODE_PAIR(fr_c_cedilla,      N0, N0, E, N7,   N0, N0, C, N7)  // ç/Ç
    // ZMK_UNICODE_PAIR(fr_e_grave,        N0, N0, E, N8,   N0, N0, C, N8)  // è/È
    // ZMK_UNICODE_PAIR(fr_e_acute,        N0, N0, E, N9,   N0, N0, C, N9)  // é/É
    // ZMK_UNICODE_PAIR(fr_e_circumflex,   N0, N0, E, A,    N0, N0, C, A)   // ê/Ê
    // ZMK_UNICODE_PAIR(fr_e_diaeresis,    N0, N0, E, B,    N0, N0, C, B)   // ë/Ë
    // ZMK_UNICODE_PAIR(fr_i_circumflex,   N0, N0, E, E,    N0, N0, C, E)   // î/Î
    // ZMK_UNICODE_PAIR(fr_i_diaeresis,    N0, N0, E, F,    N0, N0, C, F)   // ï/Ï
    // ZMK_UNICODE_PAIR(fr_o_circumflex,   N0, N0, F, N4,   N0, N0, D, N4)  // ô/Ô
    // ZMK_UNICODE_PAIR(fr_u_grave,        N0, N0, F, N9,   N0, N0, D, N9)  // ù/Ù
    // ZMK_UNICODE_PAIR(fr_u_circumflex,   N0, N0, F, B,    N0, N0, D, B)   // û/Û
    // ZMK_UNICODE_PAIR(fr_u_diaeresis,    N0, N0, F, C,    N0, N0, D, C)   // ü/Ü
    // ZMK_UNICODE_PAIR(fr_y_diaeresis,    N0, N0, F, F,    N0, N1, N7, N8) // ÿ/Ÿ
// Assumes ZMK_UNICODE_PAIR sends Alt down, then the sequence, then Alt up.
// Using Windows Alt + 0xxx (Windows-1252) method with Numeric Keypad codes.
// NOTE: This requires typing the leading zero.

ZMK_UNICODE_PAIR(fr_ae,           KP_N0, KP_N2, KP_N3, KP_N0,  KP_N0, KP_N1, KP_N9, KP_N8)  // æ(0230)/Æ(0198)
ZMK_UNICODE_PAIR(fr_oe,           KP_N0, KP_N1, KP_N5, KP_N6,  KP_N0, KP_N1, KP_N4, KP_N0)  // œ(0156)/Œ(0140)
ZMK_UNICODE_PAIR(fr_a_grave,      KP_N0, KP_N2, KP_N2, KP_N4,  KP_N0, KP_N1, KP_N9, KP_N2)  // à(0224)/À(0192)
ZMK_UNICODE_PAIR(fr_a_circumflex, KP_N0, KP_N2, KP_N2, KP_N6,  KP_N0, KP_N1, KP_N9, KP_N4)  // â(0226)/Â(0194)
ZMK_UNICODE_PAIR(fr_c_cedilla,    KP_N0, KP_N2, KP_N3, KP_N1,  KP_N0, KP_N1, KP_N9, KP_N9)  // ç(0231)/Ç(0199)
ZMK_UNICODE_PAIR(fr_e_grave,      KP_N0, KP_N2, KP_N3, KP_N2,  KP_N0, KP_N2, KP_N0, KP_N0)  // è(0232)/È(0200)
ZMK_UNICODE_PAIR(fr_e_acute,      KP_N0, KP_N2, KP_N3, KP_N3,  KP_N0, KP_N2, KP_N0, KP_N1)  // é(0233)/É(0201)
ZMK_UNICODE_PAIR(fr_e_circumflex, KP_N0, KP_N2, KP_N3, KP_N4,  KP_N0, KP_N2, KP_N0, KP_N2)  // ê(0234)/Ê(0202)
ZMK_UNICODE_PAIR(fr_e_diaeresis,  KP_N0, KP_N2, KP_N3, KP_N5,  KP_N0, KP_N2, KP_N0, KP_N3)  // ë(0235)/Ë(0203)
ZMK_UNICODE_PAIR(fr_i_circumflex, KP_N0, KP_N2, KP_N3, KP_N8,  KP_N0, KP_N2, KP_N0, KP_N6)  // î(0238)/Î(0206)
ZMK_UNICODE_PAIR(fr_i_diaeresis,  KP_N0, KP_N2, KP_N3, KP_N9,  KP_N0, KP_N2, KP_N0, KP_N7)  // ï(0239)/Ï(0207)
ZMK_UNICODE_PAIR(fr_o_circumflex, KP_N0, KP_N2, KP_N4, KP_N4,  KP_N0, KP_N2, KP_N1, KP_N2)  // ô(0244)/Ô(0212)
ZMK_UNICODE_PAIR(fr_u_grave,      KP_N0, KP_N2, KP_N4, KP_N9,  KP_N0, KP_N2, KP_N1, KP_N7)  // ù(0249)/Ù(0217)
ZMK_UNICODE_PAIR(fr_u_circumflex, KP_N0, KP_N2, KP_N5, KP_N1,  KP_N0, KP_N2, KP_N1, KP_N9)  // û(0251)/Û(0219)
ZMK_UNICODE_PAIR(fr_u_diaeresis,  KP_N0, KP_N2, KP_N5, KP_N2,  KP_N0, KP_N2, KP_N2, KP_N0)  // ü(0252)/Ü(0220)
ZMK_UNICODE_PAIR(fr_y_diaeresis,  KP_N0, KP_N2, KP_N5, KP_N5,  KP_N0, KP_N1, KP_N5, KP_N9)  // ÿ(0255)/Ÿ(0159)

    ZMK_UNICODE_PAIR(plus_minus, KP_N0, KP_N1, KP_N7, KP_N7, KP_N0, KP_N1, KP_N7, KP_N7)
    ZMK_UNICODE_PAIR(fr_apostrophe, KP_N0, KP_N1, KP_N4, KP_N6, KP_N0, KP_N1, KP_N4, KP_N6)
    ZMK_UNICODE_PAIR(fr_daqleft, KP_N0, KP_N1, KP_N7, KP_N1, KP_N0, KP_N1, KP_N4, KP_N7)
    ZMK_UNICODE_PAIR(fr_daqright, KP_N0, KP_N1, KP_N8, KP_N7, KP_N0, KP_N1, KP_N4, KP_N8)
    ZMK_UNICODE_PAIR(fr_tiret_quad, KP_N0, KP_N1, KP_N5, KP_N0, KP_N0, KP_N1, KP_N5, KP_N1)
    ZMK_UNICODE_PAIR(fr_ellipsis, KP_N0, KP_N1, KP_N3, KP_N3, KP_N0, KP_N1, KP_N3, KP_N3)


    // Symbols mod_morphs
    ZMK_MOD_MORPH(at_mu, bindings = <&kp FR_AT>, <&kp FR_MICRO>; mods = <(MOD_LSFT|MOD_RSFT)>; )
    ZMK_MOD_MORPH(pct_minus, bindings = <&kp FR_PERCENT>, <&kp FR_MINUS>; mods = <(MOD_LSFT|MOD_RSFT)>; )
    ZMK_MOD_MORPH(lt_apos, bindings = <&kp FR_LT>, <&kp RA(FR_G)>; mods = <(MOD_LSFT|MOD_RSFT)>; )
    ZMK_MOD_MORPH(gt_grave, bindings = <&kp FR_GT>, <&kp FR_GRAVE>; mods = <(MOD_LSFT|MOD_RSFT)>; )
    ZMK_MOD_MORPH(lt_apos, bindings = <&kp FR_LT>, <&kp RA(FR_G)>; mods = <(MOD_LSFT|MOD_RSFT)>; )
    ZMK_MOD_MORPH(gt_grave, bindings = <&kp FR_GT>, <&kp FR_GRAVE>; mods = <(MOD_LSFT|MOD_RSFT)>; )
    ZMK_MOD_MORPH(sqt_dqt, bindings = <&kp FR_SQT>, <&kp FR_DQT>; mods = <(MOD_LSFT|MOD_RSFT)>; )
    ZMK_MOD_MORPH(hash_tilde, bindings = <&kp FR_HASH>, <&kp FR_TILDE>; mods = <(MOD_LSFT|MOD_RSFT)>; )
    ZMK_MOD_MORPH(excl_sqr, bindings = <&kp FR_EXCL>, <&kp FR_SQUARE>; mods = <(MOD_LSFT|MOD_RSFT)>; )
    ZMK_MOD_MORPH(lpar_rpar, bindings = <&kp FR_LPAR>, <&kp FR_RPAR>; mods = <(MOD_LSFT|MOD_RSFT)>; )
    ZMK_MOD_MORPH(rpar_dqt, bindings = <&kp FR_RPAR>, <&kp FR_DQT>; mods = <(MOD_LSFT|MOD_RSFT)>; )
    ZMK_MOD_MORPH(equal_plus, bindings = <&kp FR_EQUAL>, <&kp FR_PLUS>; mods = <(MOD_LSFT|MOD_RSFT)>; )
    ZMK_MOD_MORPH(and_pipe, bindings = <&kp FR_AMPERSAND>, <&kp FR_PIPE>; mods = <(MOD_LSFT|MOD_RSFT)>; )
    ZMK_MOD_MORPH(lbrc_rbrc, bindings = <&kp FR_LBRC>, <&kp FR_RBRC>; mods = <(MOD_LSFT|MOD_RSFT)>; )
    ZMK_MOD_MORPH(hash_tild, bindings = <&kp FR_HASH>, <&kp FR_TILDE>; mods = <(MOD_LSFT|MOD_RSFT)>; )
    ZMK_MOD_MORPH(aster_fslh, bindings = <&kp FR_ASTERISK>, <&kp FR_FSLH>; mods = <(MOD_LSFT|MOD_RSFT)>; )
    ZMK_MOD_MORPH(bslh_deg, bindings = <&kp FR_BSLH>, <&kp FR_DEG>; mods = <(MOD_LSFT|MOD_RSFT)>; )
    ZMK_MOD_MORPH(doll_pnd, bindings = <&kp FR_DOLLAR>, <&kp FR_POUND_SIGN>; mods = <(MOD_LSFT|MOD_RSFT)>; )
    ZMK_MOD_MORPH(kp_l_r_par, bindings = <&kp FR_LPAR>, <&kp FR_RPAR>; mods = <(MOD_LSFT|MOD_RSFT)>; )


    // Reset and Bootloader
    ZMK_MOD_MORPH(reset_booloader, bindings=<&sys_reset>, <&bootloader>; mods = <(MOD_LSFT|MOD_RSFT)>;)
    ZMK_TAP_DANCE(td_reset, bindings=<&none>, <&none>, <&reset_booloader>;)


    // Combos
    ZMK_COMBO(qu, &qu_macro,  LT4 LT3)
    ZMK_COMBO(td_colon,  &kp FR_COLON,  LM1 LB1)
    ZMK_COMBO(sc_0,      &kp FR_N0,     LM2 LB2)

    ZMK_COMBO(nh_circ,   &kp RA(FR_C_CEDILLA),  RM1 RB1)
    ZMK_COMBO(ecomm_dol, &kp FR_DOLLAR,  RM2 RB2)
    ZMK_COMBO(mn_semi,   &kp FR_SEMICOLON, RM0 RM1)

    // Mouse layer access
    ZMK_COMBO(mo_mouse,  &mo MOUSE_TP,   LM5 LB5)

    // Locking num layer with toggle
    ZMK_TAP_DANCE(lock_num, bindings=<&to NUMS>, <&tog NUMS>;tapping-term-ms=<300>;)
    ZMK_COMBO(tog_num,    &lock_num,     RM5 RB5, NUMS)
    ZMK_TAP_DANCE(lock_nav, bindings=<&to NAV>, <&tog NAV>;tapping-term-ms=<300>;)
    ZMK_COMBO(tog_nav,    &lock_nav,     RM5 RB5, NAV)

    // Leader sequences
    ZMK_MACRO(macro_first_name, bindings=<&kp R>;)
    ZMK_MACRO(macro_last_name, bindings=<&kp R>;)
    // [redacted]
    ZMK_MACRO(macro_tel, bindings=<&kp R>;)

    ZMK_LEADER_SEQUENCE(first_name,    &macro_first_name, R P)
    ZMK_LEADER_SEQUENCE(last_name,   &macro_last_name, R D)
    ZMK_LEADER_SEQUENCE(telephone,  &macro_tel, R T)
    // Case mods
    ZMK_LEADER_SEQUENCE(snake_mod,  &case_mod SNAKE, S)
    ZMK_LEADER_SEQUENCE(camel_mod,  &case_mod CAMEL, C)
    ZMK_LEADER_SEQUENCE(kebab_mod,  &case_mod KEBAB, K)
    ZMK_LEADER_SEQUENCE(path_mod,  &case_mod PATH_CASE, FR_D)
    ZMK_LEADER_SEQUENCE(slsh_mod,  &case_mod SLSH_CASE, FR_V)
    ZMK_LEADER_SEQUENCE(pascal_mod, &pascal_case, P)
    ZMK_LEADER_SEQUENCE(constant_mod, &constant_case, T)
    ZMK_LEADER_SEQUENCE(numpad_numword, &num_word EXCEL, N)
    ZMK_LEADER_SEQUENCE(numleft_numword, &num_word NUMS, FR_M)


    &num_word {
        continue-list = <BSPC DEL
            FR_N0 FR_N1 FR_N2 FR_N3 FR_N4 FR_N5 FR_N6 FR_N7 FR_N8 FR_N9
            FR_DOT FR_COMMA FR_PLUS FR_MINUS FR_ASTRK FR_SLASH FR_EQUAL FR_RPAR FR_LPAR
            KP_N1 KP_N2 KP_N3 KP_N4 KP_N5 KP_N6 KP_N7 KP_N8 KP_N9 KP_N0
            KP_DOT KP_PLUS KP_MINUS KP_ASTERISK KP_SLASH
            >;
        ignore-modifiers;
    };




    // Snake case with urob's zmk-auto-layer
    ZMK_AUTO_LAYER(case_mod, ignore-alphas; ignore-numbers; ignore-modifiers;continue-list=<SPACE FR_UNDER FR_MINUS DEL BSPC LEFT RIGHT FR_BSLH FR_SLASH FR_M>;)
    ZMK_MACRO(end_sep_mod, bindings=<&kp BSPC &kp SPACE>, <&to BASE>;)
    ZMK_MACRO(end_camel, bindings=<&to BASE &kp SPACE>, <&to BASE>;)
    ZMK_MACRO(pascal_case, bindings=<&macro_tap &sk LSHFT>, <&case_mod CAMEL>;)
    ZMK_MACRO(constant_case, bindings=<&caps_word>, <&case_mod SNAKE>;)


    // ZMK_ADAPTIVE_KEY(camel, bindings=<LSHFT>; )
/ {
    behaviors {
        ak_camel: ak_camel {
            compatible = "zmk,behavior-adaptive-key";
            #binding-cells = <0>;
            bindings = <&sk LSHFT>;

            akt_shft {trigger-keys = <LSHFT>; bindings = <&end_camel>;};
        };

        ak_snake: ak_snake {
            compatible = "zmk,behavior-adaptive-key";
            #binding-cells = <0>;
            bindings = <&kp FR_UNDER>;

            akt_under {trigger-keys = <FR_UNDER>; bindings = <&end_sep_mod>;};
        };

        ak_kebab: ak_kebab {
            compatible = "zmk,behavior-adaptive-key";
            #binding-cells = <0>;
            bindings = <&kp FR_MINUS>;

            akt_kebab {trigger-keys = <FR_MINUS>; bindings = <&end_sep_mod>;};
        };

        ak_bslh: ak_bslh {
            compatible = "zmk,behavior-adaptive-key";
            #binding-cells = <0>;
            bindings = <&kp FR_BSLH>;

            akt_bslh {trigger-keys = <FR_BSLH>; bindings = <&end_sep_mod>;};
        };

        ak_slash: ak_slash {
            compatible = "zmk,behavior-adaptive-key";
            #binding-cells = <0>;
            bindings = <&kp FR_SLASH>;

            akt_slash {trigger-keys = <FR_SLASH>; bindings = <&end_sep_mod>;};
        };
    };
};

/ {
    aliases {
        led-red = &led0;
        led-green = &led1;
        led-blue = &led2;
    };

    leds {
        status = "okay";
    };


    behaviors {
        t_off: toggle_layer_off {
            compatible = "zmk,behavior-toggle-layer";
            #binding-cells = <1>;
            label = "Toggle Layer Off";
            toggle-mode = "off";
        };


        // Symbol mod-morphs
        // at_mu: at_mu{
        //     display-name = "@/µ";
        //     #binding-cells = <0>;
        //     compatible = "zmk,behavior-mod-morph";
        //     bindings = <&kp AT>, <&kp FR_MU>;
        //     mods = <(MOD_LSFT|MOD_RSFT)>;
        // };

        // pct_minus: pct_minus{
        //     display-name = "%/-";
        //     #binding-cells = <0>;
        //     compatible = "zmk,behavior-mod-morph";
        //     bindings = <&kp FR_PERCENT>, <&kp MINUS>;
        //     mods = <(MOD_LSFT|MOD_RSFT)>;
        // };

        // lt_apos: lt_apos{
        //     display-name = "</'";
        //     #binding-cells = <0>;
        //     compatible = "zmk,behavior-mod-morph";
        //     bindings = <&kp FR_LT>, <&kp RA(FR_G)>;
        //     mods = <(MOD_LSFT|MOD_RSFT)>;
        // };

        // gt_grave: gt_grave{
        //     display-name = ">/`";
        //     #binding-cells = <0>;
        //     compatible = "zmk,behavior-mod-morph";
        //     bindings = <&kp FR_GT>, <&kp FR_GRAVE>;
        //     mods = <(MOD_LSFT|MOD_RSFT)>;
        // };

        // sqt_dqt: sqt_dqt{
        //     display-name = "'/ dqot";
        //     #binding-cells = <0>;
        //     compatible = "zmk,behavior-mod-morph";
        //     bindings = <&kp FR_SQT>, <&kp FR_DQT>;
        //     mods = <(MOD_LSFT|MOD_RSFT)>;
        // };

        // hash_tilde: hash_tilde{
        //     display-name = "#/~";
        //     #binding-cells = <0>;
        //     compatible = "zmk,behavior-mod-morph";
        //     bindings = <&kp FR_HASH>, <&kp FR_TILDE>;
        //     mods = <(MOD_LSFT|MOD_RSFT)>;
        // };

        // excl_sqr: excl_sqr{
        //     display-name = "!/²";
        //     #binding-cells = <0>;
        //     compatible = "zmk,behavior-mod-morph";
        //     bindings = <&kp FR_EXCL>, <&kp FR_SQUARE>;
        //     mods = <(MOD_LSFT|MOD_RSFT)>;
        // };

        // lpar_rpar: lpar_rpar{
        //     display-name = "(/)";
        //     #binding-cells = <0>;
        //     compatible = "zmk,behavior-mod-morph";
        //     bindings = <&kp FR_LPAR>, <&kp FR_RPAR>;
        //     mods = <(MOD_LSFT|MOD_RSFT)>;
        // };

        // rpar_dqt: rpar_dqt{
        //     display-name = ")/ dqot";
        //     #binding-cells = <0>;
        //     compatible = "zmk,behavior-mod-morph";
        //     bindings = <&kp FR_RPAR>, <&kp FR_DQT>;
        //     mods = <(MOD_LSFT|MOD_RSFT)>;
        // };
        // equal_plus: equal_plus{
        //     display-name = "=/+";
        //     #binding-cells = <0>;
        //     compatible = "zmk,behavior-mod-morph";
        //     bindings = <&kp FR_EQUAL>, <&kp FR_PLUS>;
        //     mods = <(MOD_LSFT|MOD_RSFT)>;
        // };
        // and_pipe: and_pipe{
        //     display-name = "&/|";
        //     #binding-cells = <0>;
        //     compatible = "zmk,behavior-mod-morph";
        //     bindings = <&kp FR_AMPERSAND>, <&kp FR_PIPE>;
        //     mods = <(MOD_LSFT|MOD_RSFT)>;
        // };
        // lbrc_rbrc: lbrc_rbrc{
        //     display-name = "{/}";
        //     #binding-cells = <0>;
        //     compatible = "zmk,behavior-mod-morph";
        //     bindings = <&kp FR_LBRC>, <&kp FR_RBRC>;
        //     mods = <(MOD_LSFT|MOD_RSFT)>;
        // };
        // hash_tild: hash_tild{
        //     display-name = "#/~";
        //     #binding-cells = <0>;
        //     compatible = "zmk,behavior-mod-morph";
        //     bindings = <&kp FR_HASH>, <&kp FR_TILDE>;
        //     mods = <(MOD_LSFT|MOD_RSFT)>;
        // };
        // aster_fslh: aster_fslh{
        //     display-name = "*/:";
        //     #binding-cells = <0>;
        //     compatible = "zmk,behavior-mod-morph";
        //     bindings = <&kp FR_ASTERISK>, <&kp FR_FSLH>;
        //     mods = <(MOD_LSFT|MOD_RSFT)>;
        // };

        // bslh_deg: bslh_deg{
        //     display-name = "\\/°";
        //     #binding-cells = <0>;
        //     compatible = "zmk,behavior-mod-morph";
        //     bindings = <&kp FR_BSLH>, <&kp FR_DEG>;
        //     mods = <(MOD_LSFT|MOD_RSFT)>;
        // };

        // doll_pnd: doll_pnd {
        //     display-name = "$/£";
        //     #binding-cells = <0>;
        //     compatible = "zmk,behavior-mod-morph";
        //     bindings = <&kp FR_DOLLAR>, <&kp FR_POUND_SIGN>;
        //     mods = <(MOD_LSFT|MOD_RSFT)>;

        // };

        // kp_l_r_par: kp_l_r_par {
        //     display-name = "()";
        //     #binding-cells = <0>;
        //     compatible = "zmk,behavior-mod-morph";
        //     bindings = <&kp FR_LPAR>, <&kp FR_RPAR>;
        //     mods = <(MOD_LSFT|MOD_RSFT)>;
        // };

        ht_sk: hold_tap_sticky {
            compatible = "zmk,behavior-hold-tap";
            #binding-cells = <2>;
            flavor = "tap-preferred";
            tapping-term-ms = <200>;
            bindings = <&mt>, <&sk>;
        };

        td_shft_capw: td_shft_capw {
            display-name = "Shift/Caps Word";
            #binding-cells = <0>;
            compatible = "zmk,behavior-tap-dance";
            bindings = <&sk LSHIFT>, <&caps_word>, <&kp CAPS>;
            tapping-term-ms = <350>;
        };
            // bindings = <&ht_sk LSHIFT LSHIFT>, <&caps_word>, <&kp CAPS>;


        STICKY_TOGGLE(BaseM, BASE_M);
        STICKY_TOGGLE(NavM, NAV_M);

    };



    macros {

        qu_macro: qu_macro {
            display-name = "qu";
            compatible = "zmk,behavior-macro";
            #binding-cells = <0>;
            bindings = <&kp FR_Q>, <&kp FR_U>;
        };
        vim_syst_clip: vim_syst_clip {
            display-name = "vim paste";
            compatible = "zmk,behavior-macro";
            #binding-cells = <0>;
            bindings
                = <&macro_tap &kp FR_DQT>
                , <&macro_tap &kp FR_PLUS>
                ;
        };

        vim_last_yank: vim_last_yank {
            display-name = "vim last yank";
            compatible = "zmk,behavior-macro";
            #binding-cells = <0>;
            bindings
                = <&macro_tap &kp FR_DQT>
                , <&macro_tap &kp FR_N0>
                , <&macro_tap &kp FR_P>
                ;
        };


    };

        keymap {
                compatible = "zmk,keymap";
// ▄▄▄▄▄▄▄▄▄▄▄▄▄▄▄▄▄▄▄▄▄▄▄▄▄▄▄▄▄▄▄▄▄▄▄▄▄▄▄▄▄▄▄▄▄▄▄▄▄▄▄▄▄▄▄▄▄▄▄▄▄▄▄▄▄▄▄▄▄▄▄▄▄▄▄▄▄▄▄▄▄▄▄▄▄▄▄▄▄▄▄▄▄▄▄▄▄▄▄▄▄▄▄▄▄▄▄▄▄▄▄▄▄▄▄▄▄▄▄▄▄▄▄▄▄▄▄▄▄▄▄▄▄▄▄▄▄▄▄▄▄▄▄▄▄▄▄▄▄

base_layer {
// ┏━━━━━━━━━━━━━━━━━━━━━━━━━━━━━━━━━━━━━━━┓
display-name= "BASE"                              ;
// ┗━━━━━━━━━━━━━━━━━━━━━━━━━━━━━━━━━━━━━━━┛
//             ┏━━━━━━━━━━━━━┳━━━━━━━━━━━━━┳━━━━━━━━━━━━━┳━━━━━━━━━━━━━┳━━━━━━━━━━━━━┓   ┏━━━━━━━━━━━━━┳━━━━━━━━━━━━━┳━━━━━━━━━━━━━┳━━━━━━━━━━━━━┳━━━━━━━━━━━━━┓
//             ┃     Q       ┃     Z       ┃     F       ┃     P       ┃     B       ┃   ┃     J       ┃     L       ┃     O       ┃   dead      ┃     Y       ┃
// ┏━━━━━━━━━━━╋━━━━━━━━━━━━━╋━━━━━━━━━━━━━╋━━━━━━━━━━━━━╋━━━━━━━━━━━━━╋━━━━━━━━━━━━━┫   ┣━━━━━━━━━━━━━╋━━━━━━━━━━━━━╋━━━━━━━━━━━━━╋━━━━━━━━━━━━━╋━━━━━━━━━━━━━╋━━━━━━━━━━━┓
// ┃  LSHFT    ┃     A       ┃     R       ┃     S       ┃     T       ┃     G       ┃   ┃     M       ┃     N       ┃     E       ┃     I       ┃     U       ┃   - ?     ┃
// ┣━━━━━━━━━━━╋━━━━━━━━━━━━━╋━━━━━━━━━━━━━╋━━━━━━━━━━━━━╋━━━━━━━━━━━━━╋━━━━━━━━━━━━━┫   ┣━━━━━━━━━━━━━╋━━━━━━━━━━━━━╋━━━━━━━━━━━━━╋━━━━━━━━━━━━━╋━━━━━━━━━━━━━╋━━━━━━━━━━━┫
// ┃  swap     ┃     W       ┃     X       ┃     C       ┃     D       ┃     V       ┃   ┃     K       ┃     H       ┃    , ;      ┃    . _      ┃    / :      ┃  swap     ┃
// ┗━━━━━━━━━━━┻━━━━━━━━━━━━━┻━━━━━━━━━━━━━╋━━━━━━━━━━━━━╋━━━━━━━━━━━━━╋━━━━━━━━━━━━━┫   ┣━━━━━━━━━━━━━╋━━━━━━━━━━━━━╋━━━━━━━━━━━━━╋━━━━━━━━━━━━━┻━━━━━━━━━━━━━┻━━━━━━━━━━━┛
//                                         ┃    ESC      ┃    SPC      ┃    TAB      ┃   ┃   ENTER     ┃   BSPC      ┃   DELETE    ┃
//                                         ┗━━━━━━━━━━━━━┻━━━━━━━━━━━━━┻━━━━━━━━━━━━━┛   ┗━━━━━━━━━━━━━┻━━━━━━━━━━━━━┻━━━━━━━━━━━━━┛
 bindings = <
// ╷           ╷             ╷             ╷             ╷             ╷             ╷   ╷             ╷             ╷             ╷             ╷             ╷           ╷

                &kp FR_Q      &kp FR_Z      &kp F         &kp P         &kp B             &kp J         &kp L         &kp O         &sl ACCENT    &kp FR_Y
&td_shft_capw   &hml LGUI FR_A &hml LALT R  &hml LSHFT S  &hml LCTRL T  &kp G             &kp FR_M      &hmr RCTRL N  &hmr RSHFT E  &hmr LALT I   &hmr RGUI U   &under_qmark
  &sl_togBaseM  &kp FR_W      &kp X         &kp C         &hml RALT D   &kp V             &kp K         &hmr RALT H   &comma_semi   &dot_colon    &minus_slash  &sl_togBaseM
                                &lt APPS ESC       &lt EXCEL SPACE     &lt NAV TAB        &lt NUMS RET       &lt SYM BSPC      &lt FUNCTION_L DEL
            >;
    };

base_M_layer {
// ┏━━━━━━━━━━━━━━━━━━━━━━━━━━━━━━━━━━━━━━━┓
display-name= "BASE_M"                              ;
// ┗━━━━━━━━━━━━━━━━━━━━━━━━━━━━━━━━━━━━━━━┛
//             ┏━━━━━━━━━━━━━┳━━━━━━━━━━━━━┳━━━━━━━━━━━━━┳━━━━━━━━━━━━━┳━━━━━━━━━━━━━┓   ┏━━━━━━━━━━━━━┳━━━━━━━━━━━━━┳━━━━━━━━━━━━━┳━━━━━━━━━━━━━┳━━━━━━━━━━━━━┓
//             ┃     Y       ┃   dead      ┃     O       ┃     L       ┃     J       ┃   ┃     B       ┃     P       ┃     F       ┃     Z       ┃     Q       ┃
// ┏━━━━━━━━━━━╋━━━━━━━━━━━━━╋━━━━━━━━━━━━━╋━━━━━━━━━━━━━╋━━━━━━━━━━━━━╋━━━━━━━━━━━━━┫   ┣━━━━━━━━━━━━━╋━━━━━━━━━━━━━╋━━━━━━━━━━━━━╋━━━━━━━━━━━━━╋━━━━━━━━━━━━━╋━━━━━━━━━━━┓
// ┃   / :     ┃     U       ┃     I       ┃     E       ┃     N       ┃     M       ┃   ┃     G       ┃     T       ┃     S       ┃     R       ┃     A       ┃  LSHFT    ┃
// ┣━━━━━━━━━━━╋━━━━━━━━━━━━━╋━━━━━━━━━━━━━╋━━━━━━━━━━━━━╋━━━━━━━━━━━━━╋━━━━━━━━━━━━━┫   ┣━━━━━━━━━━━━━╋━━━━━━━━━━━━━╋━━━━━━━━━━━━━╋━━━━━━━━━━━━━╋━━━━━━━━━━━━━╋━━━━━━━━━━━┫
// ┃  swap     ┃    . _      ┃    , ;      ┃    - ?      ┃     H       ┃     K       ┃   ┃     V       ┃     D       ┃     C       ┃     X       ┃     W       ┃  swap     ┃
// ┗━━━━━━━━━━━┻━━━━━━━━━━━━━┻━━━━━━━━━━━━━╋━━━━━━━━━━━━━╋━━━━━━━━━━━━━╋━━━━━━━━━━━━━┫   ┣━━━━━━━━━━━━━╋━━━━━━━━━━━━━╋━━━━━━━━━━━━━╋━━━━━━━━━━━━━┻━━━━━━━━━━━━━┻━━━━━━━━━━━┛
//                                         ┃   DELETE    ┃   BSPC      ┃   ENTER     ┃   ┃    TAB      ┃    SPC      ┃    ESC      ┃
//                                         ┗━━━━━━━━━━━━━┻━━━━━━━━━━━━━┻━━━━━━━━━━━━━┛   ┗━━━━━━━━━━━━━┻━━━━━━━━━━━━━┻━━━━━━━━━━━━━┛
 bindings = <
// ╷           ╷             ╷             ╷             ╷             ╷             ╷   ╷             ╷             ╷             ╷             ╷             ╷           ╷

                &kp FR_Y      &sl ACCENT    &kp O         &kp L         &kp J             &kp B         &kp P         &kp F         &kp FR_Z      &kp FR_Q
   &under_qmark &hml RGUI U   &hml LALT I   &hml RSHFT E  &hml RCTRL N  &kp FR_M          &kp G         &hmr LCTRL T  &hmr LSHFT S  &hmr LALT R   &hmr LGUI FR_A &td_shft_capw
  &t_off BASE_M &minus_slash  &dot_colon    &comma_semi   &hml RALT H   &kp K             &kp V         &hmr RALT D   &kp C         &kp X         &kp FR_W      &t_off BASE_M
                                &lt FUNCTION_L DEL   &lt SYM BSPC      &lt EXCEL RET       &lt NAV TAB     &lt NUMS SPACE     &lt APPS ESC
            >;
    };

// todo
/*
    ZMK_UNICODE_PAIR(plus_minus, N0, N1, N7, N7, N0, N1, N7, N7)
    ZMK_UNICODE_PAIR(fr_apostrophe, N0, N1, N4, N6, N0, N1, N4, N6)
    ZMK_UNICODE_PAIR(fr_daqleft, N0, N1, N7, N1, N0, N1, N4, N7)
    ZMK_UNICODE_PAIR(fr_daqright, N0, N1, N8, N7, N0, N1, N4, N8)
    ZMK_UNICODE_PAIR(fr_tiret_quad, N0, N1, N5, N0, N0, N1, N5, N1)
    ZMK_UNICODE_PAIR(fr_ellipsis, N0, N1, N3, N3, N0, N1, N3, N3)


*/


accent_layer {
display-name= "ACCENT";
//             ┏━━━━━━━━━━━━━┳━━━━━━━━━━━━━┳━━━━━━━━━━━━━┳━━━━━━━━━━━━━┳━━━━━━━━━━━━━┓   ┏━━━━━━━━━━━━━┳━━━━━━━━━━━━━┳━━━━━━━━━━━━━┳━━━━━━━━━━━━━┳━━━━━━━━━━━━━┓
//             ┃     â       ┃     ï       ┃     î       ┃     û       ┃     '       ┃   ┃     œ       ┃             ┃     ô       ┃     ¨       ┃     ±       ┃
// ┏━━━━━━━━━━━╋━━━━━━━━━━━━━╋━━━━━━━━━━━━━╋━━━━━━━━━━━━━╋━━━━━━━━━━━━━╋━━━━━━━━━━━━━┫   ┣━━━━━━━━━━━━━╋━━━━━━━━━━━━━╋━━━━━━━━━━━━━╋━━━━━━━━━━━━━╋━━━━━━━━━━━━━╋━━━━━━━━━━━┓
// ┃  LSHFT    ┃     à       ┃     ë       ┃     ê       ┃     "       ┃     &       ┃   ┃     ’       ┃     é       ┃     è       ┃     µ       ┃     ù       ┃    /      ┃
// ┣━━━━━━━━━━━╋━━━━━━━━━━━━━╋━━━━━━━━━━━━━╋━━━━━━━━━━━━━╋━━━━━━━━━━━━━╋━━━━━━━━━━━━━┫   ┣━━━━━━━━━━━━━╋━━━━━━━━━━━━━╋━━━━━━━━━━━━━╋━━━━━━━━━━━━━╋━━━━━━━━━━━━━╋━━━━━━━━━━━┫
// ┃  swap     ┃     ae      ┃     €       ┃     ç       ┃     ^       ┃     \       ┃   ┃     «       ┃     »       ┃     ‑       ┃     …       ┃     !       ┃  swap     ┃
// ┗━━━━━━━━━━━┻━━━━━━━━━━━━━┻━━━━━━━━━━━━━╋━━━━━━━━━━━━━╋━━━━━━━━━━━━━╋━━━━━━━━━━━━━┫   ┣━━━━━━━━━━━━━╋━━━━━━━━━━━━━╋━━━━━━━━━━━━━╋━━━━━━━━━━━━━┻━━━━━━━━━━━━━┻━━━━━━━━━━━┛
//                                         ┃    ESC      ┃    SPC      ┃    TAB      ┃   ┃   ENTER     ┃   BSPC      ┃   DELETE    ┃
//                                         ┗━━━━━━━━━━━━━┻━━━━━━━━━━━━━┻━━━━━━━━━━━━━┛   ┗━━━━━━━━━━━━━┻━━━━━━━━━━━━━┻━━━━━━━━━━━━━┛
bindings = <
// ╷           ╷             ╷             ╷             ╷             ╷             ╷   ╷             ╷             ╷             ╷             ╷             ╷           ╷

                &fr_a_circumflex &fr_i_diaeresis &fr_i_circumflex &fr_u_circumflex &kp FR_SQT           &fr_oe         XXX            &fr_o_circumflex     &kp FR_UMLAUT    &plus_minus
     ___        &fr_a_grave      &fr_e_diaeresis &fr_e_circumflex &kp DQT          &and_pipe            &fr_apostrophe &fr_e_acute    &fr_e_grave          &kp FR_MU       &fr_u_grave  ___
     ___        &fr_ae           &kp FR_EURO     &fr_c_cedilla    &kp FR_CARET     &kp FR_BSLH          &fr_daqleft    &fr_daqright   &fr_tiret_quad       &fr_ellipsis    &kp FR_EXCL    ___
                                            &kp RA(SPACE) &fr_apostrophe ___               ___           ___           ___
        >;
    };

symbol_layer {
display-name= "SYMBOL";
//             ┏━━━━━━━━━━━━━┳━━━━━━━━━━━━━┳━━━━━━━━━━━━━┳━━━━━━━━━━━━━┳━━━━━━━━━━━━━┓   ┏━━━━━━━━━━━━━┳━━━━━━━━━━━━━┳━━━━━━━━━━━━━┳━━━━━━━━━━━━━┳━━━━━━━━━━━━━┓
//             ┃    @ µ      ┃    % -      ┃     <       ┃     >       ┃     '       ┃   ┃     "       ┃     [       ┃     ]       ┃ camel mod   ┃  snake mod  ┃
// ┏━━━━━━━━━━━╋━━━━━━━━━━━━━╋━━━━━━━━━━━━━╋━━━━━━━━━━━━━╋━━━━━━━━━━━━━╋━━━━━━━━━━━━━┫   ┣━━━━━━━━━━━━━╋━━━━━━━━━━━━━╋━━━━━━━━━━━━━╋━━━━━━━━━━━━━╋━━━━━━━━━━━━━╋━━━━━━━━━━━┓
// ┃  LSHFT    ┃     #       ┃     !       ┃     (       ┃     )       ┃     =       ┃   ┃     `       ┃  osm RCTRL  ┃  osm RSHFT  ┃  osm LALT   ┃  osm RGUI   ┃    /      ┃
// ┣━━━━━━━━━━━╋━━━━━━━━━━━━━╋━━━━━━━━━━━━━╋━━━━━━━━━━━━━╋━━━━━━━━━━━━━╋━━━━━━━━━━━━━┫   ┣━━━━━━━━━━━━━╋━━━━━━━━━━━━━╋━━━━━━━━━━━━━╋━━━━━━━━━━━━━╋━━━━━━━━━━━━━╋━━━━━━━━━━━┫
// ┃  swap     ┃     ^       ┃     &       ┃     *       ┃     \       ┃     $       ┃   ┃     '       ┃     {       ┃     }       ┃  osm RALT   ┃             ┃  swap     ┃
// ┗━━━━━━━━━━━┻━━━━━━━━━━━━━┻━━━━━━━━━━━━━╋━━━━━━━━━━━━━╋━━━━━━━━━━━━━╋━━━━━━━━━━━━━┫   ┣━━━━━━━━━━━━━╋━━━━━━━━━━━━━╋━━━━━━━━━━━━━╋━━━━━━━━━━━━━┻━━━━━━━━━━━━━┻━━━━━━━━━━━┛
//                                         ┃    ESC      ┃    leader   ┃    TAB      ┃   ┃   ENTER     ┃   BSPC      ┃   DELETE    ┃
//                                         ┗━━━━━━━━━━━━━┻━━━━━━━━━━━━━┻━━━━━━━━━━━━━┛   ┗━━━━━━━━━━━━━┻━━━━━━━━━━━━━┻━━━━━━━━━━━━━┛
bindings = <
// ╷           ╷             ╷             ╷             ╷             ╷             ╷   ╷             ╷             ╷             ╷             ╷             ╷           ╷

                &at_mu        &pct_minus    &lt_apos      &gt_grave     &sqt_dqt          &kp FR_DQT    &kp FR_LBKT   &kp FR_RBKT   &case_mod CAMEL &case_mod SNAKE
     ___        &hash_tilde   &excl_sqr     &lpar_rpar    &rpar_dqt     &equal_plus       &kp FR_GRAVE  &sk RCTRL     &td_shft_capw &sk LALT      &skl RGUI       ___
     ___        &kp FR_CARET  &and_pipe     &aster_fslh   &bslh_deg     &doll_pnd         &kp FR_SQT    &kp FR_LBRC   &kp FR_RBRC   &sk RALT       XXX           ___
                                             ___          &leader        ___               ___           ___           ___
        >;
    };

num_layer {
display-name= "NUMBER";
//             ┏━━━━━━━━━━━━━┳━━━━━━━━━━━━━┳━━━━━━━━━━━━━┳━━━━━━━━━━━━━┳━━━━━━━━━━━━━┓   ┏━━━━━━━━━━━━━┳━━━━━━━━━━━━━┳━━━━━━━━━━━━━┳━━━━━━━━━━━━━┳━━━━━━━━━━━━━┓
//             ┃     /       ┃     7       ┃     8       ┃     9       ┃     -       ┃   ┃             ┃             ┃             ┃             ┃             ┃
// ┏━━━━━━━━━━━╋━━━━━━━━━━━━━╋━━━━━━━━━━━━━╋━━━━━━━━━━━━━╋━━━━━━━━━━━━━╋━━━━━━━━━━━━━┫   ┣━━━━━━━━━━━━━╋━━━━━━━━━━━━━╋━━━━━━━━━━━━━╋━━━━━━━━━━━━━╋━━━━━━━━━━━━━╋━━━━━━━━━━━┓
// ┃    (      ┃     0       ┃     4       ┃     5       ┃     6       ┃     +       ┃   ┃             ┃  osm RCTRL  ┃  osm RSHFT  ┃  osm LALT   ┃   osm RGUI  ┃           ┃
// ┣━━━━━━━━━━━╋━━━━━━━━━━━━━╋━━━━━━━━━━━━━╋━━━━━━━━━━━━━╋━━━━━━━━━━━━━╋━━━━━━━━━━━━━┫   ┣━━━━━━━━━━━━━╋━━━━━━━━━━━━━╋━━━━━━━━━━━━━╋━━━━━━━━━━━━━╋━━━━━━━━━━━━━╋━━━━━━━━━━━┫
// ┃  swap     ┃     *       ┃     1       ┃     2       ┃     3       ┃     =       ┃   ┃             ┃  osm RALT   ┃             ┃             ┃             ┃  swap     ┃
// ┗━━━━━━━━━━━┻━━━━━━━━━━━━━┻━━━━━━━━━━━━━╋━━━━━━━━━━━━━╋━━━━━━━━━━━━━╋━━━━━━━━━━━━━┫   ┣━━━━━━━━━━━━━╋━━━━━━━━━━━━━╋━━━━━━━━━━━━━╋━━━━━━━━━━━━━┻━━━━━━━━━━━━━┻━━━━━━━━━━━┛
//                                         ┃    ESC      ┃    SPC      ┃    TAB      ┃   ┃   ENTER     ┃   BSPC      ┃   DELETE    ┃
//                                         ┗━━━━━━━━━━━━━┻━━━━━━━━━━━━━┻━━━━━━━━━━━━━┛   ┗━━━━━━━━━━━━━┻━━━━━━━━━━━━━┻━━━━━━━━━━━━━┛
bindings = <
// ╷           ╷             ╷             ╷             ╷             ╷             ╷   ╷             ╷             ╷             ╷             ╷             ╷           ╷

                &kp FR_SLASH  &kp FR_N7     &kp FR_N8     &kp FR_N9     &kp FR_MINUS       XXX           XXX           XXX           XXX           XXX
    &kp_l_r_par &kp FR_N0     &kp FR_N4     &kp FR_N5     &kp FR_N6     &kp FR_PLUS        XXX          &sk RCTRL     &sk RSHFT     &sk LALT      &skl RGUI       ___
     ___        &kp FR_ASTRK  &kp FR_N1     &kp FR_N2     &kp FR_N3     &kp FR_EQUAL       XXX          &sk RALT       XXX           XXX           XXX           ___
                                            &kp FR_DOT     ___           ___               ___           ___           ___
        >;
    };

navigation_layer {
display-name= "NAVIGATION";
//             ┏━━━━━━━━━━━━━┳━━━━━━━━━━━━━┳━━━━━━━━━━━━━┳━━━━━━━━━━━━━┳━━━━━━━━━━━━━┓   ┏━━━━━━━━━━━━━┳━━━━━━━━━━━━━┳━━━━━━━━━━━━━┳━━━━━━━━━━━━━┳━━━━━━━━━━━━━┓
//             ┃   ctrl+A    ┃   ctrl+X    ┃   ctrl+C    ┃   ctrl+V    ┃ vim syst cli┃   ┃   Insert    ┃    Home     ┃    End      ┃             ┃             ┃
// ┏━━━━━━━━━━━╋━━━━━━━━━━━━━╋━━━━━━━━━━━━━╋━━━━━━━━━━━━━╋━━━━━━━━━━━━━╋━━━━━━━━━━━━━┫   ┣━━━━━━━━━━━━━╋━━━━━━━━━━━━━╋━━━━━━━━━━━━━╋━━━━━━━━━━━━━╋━━━━━━━━━━━━━╋━━━━━━━━━━━┓
// ┃  LSHFT    ┃ osm LGUI    ┃  osm LALT   ┃  osm LSHFT  ┃  osm LCTRL  ┃   ctrl+Z    ┃   ┃ Print Screen┃    Left     ┃    Down     ┃     Up      ┃    Right    ┃           ┃
// ┣━━━━━━━━━━━╋━━━━━━━━━━━━━╋━━━━━━━━━━━━━╋━━━━━━━━━━━━━╋━━━━━━━━━━━━━╋━━━━━━━━━━━━━┫   ┣━━━━━━━━━━━━━╋━━━━━━━━━━━━━╋━━━━━━━━━━━━━╋━━━━━━━━━━━━━╋━━━━━━━━━━━━━╋━━━━━━━━━━━┫
// ┃  swap     ┃ vim last Y  ┃  alt+F4     ┃ alt+ctrl+gui┃  osm RALT   ┃   ctrl+Y    ┃   ┃   Pause     ┃   Page Up   ┃   Page Down ┃             ┃  Context Men┃  swap     ┃
// ┗━━━━━━━━━━━┻━━━━━━━━━━━━━┻━━━━━━━━━━━━━╋━━━━━━━━━━━━━╋━━━━━━━━━━━━━╋━━━━━━━━━━━━━┫   ┣━━━━━━━━━━━━━╋━━━━━━━━━━━━━╋━━━━━━━━━━━━━╋━━━━━━━━━━━━━┻━━━━━━━━━━━━━┻━━━━━━━━━━━┛
//                                         ┃    ESC      ┃    SPC      ┃    TAB      ┃   ┃   ENTER     ┃   BSPC      ┃   DELETE    ┃
//                                         ┗━━━━━━━━━━━━━┻━━━━━━━━━━━━━┻━━━━━━━━━━━━━┛   ┗━━━━━━━━━━━━━┻━━━━━━━━━━━━━┻━━━━━━━━━━━━━┛
bindings = <
// ╷           ╷             ╷             ╷             ╷             ╷             ╷   ╷             ╷             ╷             ╷             ╷             ╷           ╷

                &kp LC(FR_A)  &kp LC(FR_X)  &kp LC(FR_C)  &kp LC(FR_V)  &vim_syst_clip    &kp INS       &kp HOME      &kp END        XXX           XXX
     ___        &skl LGUI      &sk LALT      &sk LSHFT     &sk LCTRL     &kp LC(FR_Z)      &kp PSCRN     &kp LEFT      &kp DOWN      &kp UP        &kp RIGHT      XXX
    &sl_togNavM &vim_last_yank &kp LA(F4)   &kp LA(LC(LGUI)) &sk RALT   &kp LC(FR_Y)      &kp PAUSE_BREAK &kp PG_UP   &kp PG_DN      XXX          &kp K_APP      &sl_togNavM
                                             ___           ___           ___               ___           ___           ___
        >;
    };

navigation_M_layer {
display-name= "NAVIGATION_M";
//             ┏━━━━━━━━━━━━━┳━━━━━━━━━━━━━┳━━━━━━━━━━━━━┳━━━━━━━━━━━━━┳━━━━━━━━━━━━━┓   ┏━━━━━━━━━━━━━┳━━━━━━━━━━━━━┳━━━━━━━━━━━━━┳━━━━━━━━━━━━━┳━━━━━━━━━━━━━┓
//             ┃             ┃             ┃    End      ┃    Home     ┃   Insert    ┃   ┃ vim syst cli┃   ctrl+V    ┃   ctrl+C    ┃   ctrl+X    ┃   ctrl+A    ┃
// ┏━━━━━━━━━━━╋━━━━━━━━━━━━━╋━━━━━━━━━━━━━╋━━━━━━━━━━━━━╋━━━━━━━━━━━━━╋━━━━━━━━━━━━━┫   ┣━━━━━━━━━━━━━╋━━━━━━━━━━━━━╋━━━━━━━━━━━━━╋━━━━━━━━━━━━━╋━━━━━━━━━━━━━╋━━━━━━━━━━━┓
// ┃           ┃    Right    ┃     Up      ┃    Down     ┃    Left     ┃ Print Screen┃   ┃   ctrl+Z    ┃  osm LCTRL  ┃  osm LSHFT  ┃  osm LALT   ┃  osm LGUI   ┃  LSHFT    ┃
// ┣━━━━━━━━━━━╋━━━━━━━━━━━━━╋━━━━━━━━━━━━━╋━━━━━━━━━━━━━╋━━━━━━━━━━━━━╋━━━━━━━━━━━━━┫   ┣━━━━━━━━━━━━━╋━━━━━━━━━━━━━╋━━━━━━━━━━━━━╋━━━━━━━━━━━━━╋━━━━━━━━━━━━━╋━━━━━━━━━━━┫
// ┃  swap     ┃ Context Men ┃             ┃   Page Down ┃   Page Up   ┃   Pause     ┃   ┃   ctrl+Y    ┃  osm RALT   ┃ alt+ctrl+gui┃  alt+F4     ┃ vim last Y  ┃  swap     ┃
// ┗━━━━━━━━━━━┻━━━━━━━━━━━━━┻━━━━━━━━━━━━━╋━━━━━━━━━━━━━╋━━━━━━━━━━━━━╋━━━━━━━━━━━━━┫   ┣━━━━━━━━━━━━━╋━━━━━━━━━━━━━╋━━━━━━━━━━━━━╋━━━━━━━━━━━━━┻━━━━━━━━━━━━━┻━━━━━━━━━━━┛
//                                         ┃   DELETE    ┃   BSPC      ┃   ENTER     ┃   ┃    TAB      ┃    SPC      ┃    ESC      ┃
//                                         ┗━━━━━━━━━━━━━┻━━━━━━━━━━━━━┻━━━━━━━━━━━━━┛   ┗━━━━━━━━━━━━━┻━━━━━━━━━━━━━┻━━━━━━━━━━━━━┛
bindings = <
// ╷           ╷             ╷             ╷             ╷             ╷             ╷   ╷             ╷             ╷             ╷             ╷             ╷           ╷

                XXX           XXX           &kp END       &kp HOME      &kp INS           &vim_syst_clip &kp LC(FR_V)  &kp LC(FR_C)  &kp LC(FR_X)  &kp LC(FR_A)
     XXX       &kp RIGHT     &kp UP        &kp DOWN      &kp LEFT      &kp PSCRN         &kp LC(FR_Z)   &sk LCTRL     &sk LSHFT     &sk LALT      &skl LGUI       ___
  &t_off NAV_M &kp K_APP      XXX           &kp PG_DN     &kp PG_UP     &kp PAUSE_BREAK   &kp LC(FR_Y)   &sk RALT      &kp LA(LC(LGUI)) &kp LA(F4) &vim_last_yank &t_off NAV_M
                                             ___           ___           ___               ___           ___           ___
        >;
};

function_layer {
display-name= "FUNCTION";
//             ┏━━━━━━━━━━━━━┳━━━━━━━━━━━━━┳━━━━━━━━━━━━━┳━━━━━━━━━━━━━┳━━━━━━━━━━━━━┓   ┏━━━━━━━━━━━━━┳━━━━━━━━━━━━━┳━━━━━━━━━━━━━┳━━━━━━━━━━━━━┳━━━━━━━━━━━━━┓
//             ┃    F12      ┃     F7      ┃     F8      ┃     F9      ┃   ScrlLock  ┃   ┃   Insert    ┃             ┃    Mute     ┃ Volume Down ┃  Volume Up  ┃
// ┏━━━━━━━━━━━╋━━━━━━━━━━━━━╋━━━━━━━━━━━━━╋━━━━━━━━━━━━━╋━━━━━━━━━━━━━╋━━━━━━━━━━━━━┫   ┣━━━━━━━━━━━━━╋━━━━━━━━━━━━━╋━━━━━━━━━━━━━╋━━━━━━━━━━━━━╋━━━━━━━━━━━━━╋━━━━━━━━━━━┓
// ┃  LSHFT    ┃    F11      ┃     F4      ┃     F5      ┃     F6      ┃ PrintScreen ┃   ┃   NumPad    ┃   R Ctrl    ┃   R Shift   ┃   L Alt     ┃   R Gui     ┃    /      ┃
// ┣━━━━━━━━━━━╋━━━━━━━━━━━━━╋━━━━━━━━━━━━━╋━━━━━━━━━━━━━╋━━━━━━━━━━━━━╋━━━━━━━━━━━━━┫   ┣━━━━━━━━━━━━━╋━━━━━━━━━━━━━╋━━━━━━━━━━━━━╋━━━━━━━━━━━━━╋━━━━━━━━━━━━━╋━━━━━━━━━━━┫
// ┃  swap     ┃    F10      ┃     F1      ┃     F2      ┃     F3      ┃   Pause     ┃   ┃             ┃   R Alt     ┃ Media Prev  ┃ Media Play  ┃ Media Next  ┃  swap     ┃
// ┗━━━━━━━━━━━┻━━━━━━━━━━━━━┻━━━━━━━━━━━━━╋━━━━━━━━━━━━━╋━━━━━━━━━━━━━╋━━━━━━━━━━━━━┫   ┣━━━━━━━━━━━━━╋━━━━━━━━━━━━━╋━━━━━━━━━━━━━╋━━━━━━━━━━━━━┻━━━━━━━━━━━━━┻━━━━━━━━━━━┛
//                                         ┃    ESC      ┃    SPC      ┃    TAB      ┃   ┃   ENTER     ┃   BSPC      ┃   DELETE    ┃
//                                         ┗━━━━━━━━━━━━━┻━━━━━━━━━━━━━┻━━━━━━━━━━━━━┛   ┗━━━━━━━━━━━━━┻━━━━━━━━━━━━━┻━━━━━━━━━━━━━┛
bindings = <

// ╷           ╷             ╷             ╷             ╷             ╷             ╷   ╷             ╷             ╷             ╷             ╷             ╷           ╷

                &kp F12       &kp F7        &kp F8        &kp F9        &kp SLCK          &kp INS        XXX          &kp C_MUTE    &kp C_VOL_DN  &kp C_VOL_UP
     ___        &kp F11       &kp F4        &kp F5        &kp F6        &kp PSCRN         &kp KP_NUM    &kp RCTRL     &kp RSHIFT    &kp LALT      &kp LGUI       XXX
     ___        &kp F10       &kp F1        &kp F2        &kp F3        &kp PAUSE_BREAK    XXX          &kp RALT      &kp C_PREV    &kp C_PLAY_PAUSE &kp C_NEXT  ___
                                             ___           ___           ___               ___           ___           ___
                        >;
                };

app_layer {
display-name= "APPS";
//             ┏━━━━━━━━━━━━━┳━━━━━━━━━━━━━┳━━━━━━━━━━━━━┳━━━━━━━━━━━━━┳━━━━━━━━━━━━━┓   ┏━━━━━━━━━━━━━┳━━━━━━━━━━━━━┳━━━━━━━━━━━━━┳━━━━━━━━━━━━━┳━━━━━━━━━━━━━┓
//             ┃  BT Sel 0   ┃ BT Sel 1    ┃ BT Sel 2    ┃ BT Sel 3    ┃ BT Clear    ┃   ┃   td_reset  ┃   Alt+L     ┃   Ctrl+²    ┃             ┃             ┃
// ┏━━━━━━━━━━━╋━━━━━━━━━━━━━╋━━━━━━━━━━━━━╋━━━━━━━━━━━━━╋━━━━━━━━━━━━━╋━━━━━━━━━━━━━┫   ┣━━━━━━━━━━━━━╋━━━━━━━━━━━━━╋━━━━━━━━━━━━━╋━━━━━━━━━━━━━╋━━━━━━━━━━━━━╋━━━━━━━━━━━┓
// ┃  LSHFT    ┃   LGUI      ┃    LALT     ┃   LSHIFT    ┃   LCTRL     ┃   td_reset  ┃   ┃ Context Menu┃   browser   ┃             ┃ Sh+Alt+Ctl+T┃             ┃    /      ┃
// ┣━━━━━━━━━━━╋━━━━━━━━━━━━━╋━━━━━━━━━━━━━╋━━━━━━━━━━━━━╋━━━━━━━━━━━━━╋━━━━━━━━━━━━━┫   ┣━━━━━━━━━━━━━╋━━━━━━━━━━━━━╋━━━━━━━━━━━━━╋━━━━━━━━━━━━━╋━━━━━━━━━━━━━╋━━━━━━━━━━━┫
// ┃  swap     ┃  out USB    ┃ out BLE     ┃   ind_bat   ┃   RALT      ┃ ind_con     ┃   ┃ Sh+Alt+Ctl+K┃  Ctrl+Alt+F ┃   Calc      ┃ Sh+Gui+S    ┃             ┃  swap     ┃
// ┗━━━━━━━━━━━┻━━━━━━━━━━━━━┻━━━━━━━━━━━━━╋━━━━━━━━━━━━━╋━━━━━━━━━━━━━╋━━━━━━━━━━━━━┫   ┣━━━━━━━━━━━━━╋━━━━━━━━━━━━━╋━━━━━━━━━━━━━╋━━━━━━━━━━━━━┻━━━━━━━━━━━━━┻━━━━━━━━━━━┛
//                                         ┃    ESC      ┃    SPC      ┃    TAB      ┃   ┃   ENTER     ┃   BSPC      ┃   DELETE    ┃
//                                         ┗━━━━━━━━━━━━━┻━━━━━━━━━━━━━┻━━━━━━━━━━━━━┛   ┗━━━━━━━━━━━━━┻━━━━━━━━━━━━━┻━━━━━━━━━━━━━┛
bindings = <

// ╷           ╷             ╷             ╷             ╷             ╷             ╷   ╷             ╷             ╷             ╷             ╷             ╷           ╷

                &bt BT_SEL 0  &bt BT_SEL 1  &bt BT_SEL 2  &bt BT_SEL 3  &bt BT_CLR        &td_reset     &kp LA(L)     &kp LC(FR_SQUARE)  XXX       XXX
     ___        &kp LGUI      &kp LALT      &kp LSHIFT    &kp LCTRL     &td_reset         &kp K_APP     &kp C_AL_WWW  XXX          &kp LS(LA(LC(T)))  XXX       ___
     ___        &out OUT_USB  &out OUT_BLE  &ind_bat      &kp RALT      &ind_con          &kp LS(LA(LC(K))) &kp LC(LA(F)) &kp C_AL_CALC XXX           XXX           ___
                                             ___           ___           ___               ___           ___           ___
                        >;
                };

mouse_layer {
display-name= "MOUSE";
//             ┏━━━━━━━━━━━━━┳━━━━━━━━━━━━━┳━━━━━━━━━━━━━┳━━━━━━━━━━━━━┳━━━━━━━━━━━━━┓   ┏━━━━━━━━━━━━━┳━━━━━━━━━━━━━┳━━━━━━━━━━━━━┳━━━━━━━━━━━━━┳━━━━━━━━━━━━━┓
//             ┃             ┃    Cut      ┃    Copy     ┃    Paste    ┃             ┃   ┃             ┃  Wheel Up   ┃ Mouse Up    ┃  Wheel Down ┃             ┃
// ┏━━━━━━━━━━━╋━━━━━━━━━━━━━╋━━━━━━━━━━━━━╋━━━━━━━━━━━━━╋━━━━━━━━━━━━━╋━━━━━━━━━━━━━┫   ┣━━━━━━━━━━━━━╋━━━━━━━━━━━━━╋━━━━━━━━━━━━━╋━━━━━━━━━━━━━╋━━━━━━━━━━━━━╋━━━━━━━━━━━┓
// ┃  LSHFT    ┃  osm LGUI   ┃  osm LALT   ┃  osm LSHIFT ┃   osm LCTRL ┃    ESC      ┃   ┃             ┃  Mouse Left ┃  Mouse Down ┃  Mouse Right┃             ┃    /      ┃
// ┣━━━━━━━━━━━╋━━━━━━━━━━━━━╋━━━━━━━━━━━━━╋━━━━━━━━━━━━━╋━━━━━━━━━━━━━╋━━━━━━━━━━━━━┫   ┣━━━━━━━━━━━━━╋━━━━━━━━━━━━━╋━━━━━━━━━━━━━╋━━━━━━━━━━━━━╋━━━━━━━━━━━━━╋━━━━━━━━━━━┫
// ┃  swap     ┃             ┃     RALT    ┃ scroll layer┃ Mouse Btn 4 ┃ Mouse Btn 5 ┃   ┃             ┃ Wheel Left  ┃             ┃ Wheel Right ┃             ┃  swap     ┃
// ┗━━━━━━━━━━━┻━━━━━━━━━━━━━┻━━━━━━━━━━━━━╋━━━━━━━━━━━━━╋━━━━━━━━━━━━━╋━━━━━━━━━━━━━┫   ┣━━━━━━━━━━━━━╋━━━━━━━━━━━━━╋━━━━━━━━━━━━━╋━━━━━━━━━━━━━┻━━━━━━━━━━━━━┻━━━━━━━━━━━┛
//                                         ┃ Mouse Btn L ┃ Mouse Btn M ┃ Mouse Btn R ┃   ┃ Mouse Btn L ┃ Mouse Btn M ┃ Mouse Btn R ┃
//                                         ┗━━━━━━━━━━━━━┻━━━━━━━━━━━━━┻━━━━━━━━━━━━━┛   ┗━━━━━━━━━━━━━┻━━━━━━━━━━━━━┻━━━━━━━━━━━━━┛
bindings = <

// ╷           ╷             ╷             ╷             ╷             ╷             ╷   ╷             ╷             ╷             ╷             ╷             ╷           ╷

                 XXX          &kp LC(FR_X)  &kp LC(FR_C)  &kp LC(FR_V)   XXX               XXX          &msc SCRL_UP  &mmv MOVE_UP  &msc SCRL_DOWN  XXX
     ___        &skl LGUI      &sk LALT      &sk LSHFT     &sk LCTRL     &kp ESC            XXX          &mmv MOVE_LEFT &mmv MOVE_DOWN &mmv MOVE_RIGHT  XXX       ___
     ___         XXX          &kp RALT      &mo MOUSE_SCR &mkp MB4      &mkp MB5           XXX          &msc SCRL_LEFT  XXX          &msc SCRL_RIGHT  XXX        ___
                                            &mkp LCLK     &mkp MCLK     &mkp RCLK         &mkp LCLK     &mkp MCLK     &mkp RCLK
                        >;
                };

mouse_layer_scroll {
display-name= "MOUSE_SCROLL";
//             ┏━━━━━━━━━━━━━┳━━━━━━━━━━━━━┳━━━━━━━━━━━━━┳━━━━━━━━━━━━━┳━━━━━━━━━━━━━┓   ┏━━━━━━━━━━━━━┳━━━━━━━━━━━━━┳━━━━━━━━━━━━━┳━━━━━━━━━━━━━┳━━━━━━━━━━━━━┓
//             ┃             ┃    Cut      ┃    Copy     ┃    Paste    ┃             ┃   ┃             ┃  Wheel Up   ┃ Mouse Up    ┃  Wheel Down ┃             ┃
// ┏━━━━━━━━━━━╋━━━━━━━━━━━━━╋━━━━━━━━━━━━━╋━━━━━━━━━━━━━╋━━━━━━━━━━━━━╋━━━━━━━━━━━━━┫   ┣━━━━━━━━━━━━━╋━━━━━━━━━━━━━╋━━━━━━━━━━━━━╋━━━━━━━━━━━━━╋━━━━━━━━━━━━━╋━━━━━━━━━━━┓
// ┃  LSHFT    ┃  osm LGUI   ┃  osm LALT   ┃  osm LSHIFT ┃   osm LCTRL ┃    ESC      ┃   ┃             ┃  Mouse Left ┃  Mouse Down ┃  Mouse Right┃             ┃    /      ┃
// ┣━━━━━━━━━━━╋━━━━━━━━━━━━━╋━━━━━━━━━━━━━╋━━━━━━━━━━━━━╋━━━━━━━━━━━━━╋━━━━━━━━━━━━━┫   ┣━━━━━━━━━━━━━╋━━━━━━━━━━━━━╋━━━━━━━━━━━━━╋━━━━━━━━━━━━━╋━━━━━━━━━━━━━╋━━━━━━━━━━━┫
// ┃  swap     ┃             ┃     RALT    ┃             ┃ Mouse Btn 4 ┃ Mouse Btn 5 ┃   ┃             ┃ Wheel Left  ┃             ┃ Wheel Right ┃             ┃  swap     ┃
// ┗━━━━━━━━━━━┻━━━━━━━━━━━━━┻━━━━━━━━━━━━━╋━━━━━━━━━━━━━╋━━━━━━━━━━━━━╋━━━━━━━━━━━━━┫   ┣━━━━━━━━━━━━━╋━━━━━━━━━━━━━╋━━━━━━━━━━━━━╋━━━━━━━━━━━━━┻━━━━━━━━━━━━━┻━━━━━━━━━━━┛
//                                         ┃ Mouse Btn L ┃ Mouse Btn M ┃ Mouse Btn R ┃   ┃ Mouse Btn L ┃ Mouse Btn M ┃ Mouse Btn R ┃
//                                         ┗━━━━━━━━━━━━━┻━━━━━━━━━━━━━┻━━━━━━━━━━━━━┛   ┗━━━━━━━━━━━━━┻━━━━━━━━━━━━━┻━━━━━━━━━━━━━┛
bindings = <

// ╷           ╷             ╷             ╷             ╷             ╷             ╷   ╷             ╷             ╷             ╷             ╷             ╷           ╷

                 ___           ___           ___           ___           XXX               XXX         ___           ___           ___            XXX
     ___         ___           ___           ___           ___           ___               ___         ___           ___           ___           ___           ___
     ___         ___           ___           ___           ___           ___               ___         ___           ___           ___           ___           ___
                                             ___           ___           ___               ___         ___           ___
                        >;
                };

excel_layer {
display-name= "EXCEL";
//             ┏━━━━━━━━━━━━━┳━━━━━━━━━━━━━┳━━━━━━━━━━━━━┳━━━━━━━━━━━━━┳━━━━━━━━━━━━━┓   ┏━━━━━━━━━━━━━┳━━━━━━━━━━━━━┳━━━━━━━━━━━━━┳━━━━━━━━━━━━━┳━━━━━━━━━━━━━┓
//             ┃    Left     ┃   Down      ┃     Up      ┃    Right    ┃     F2      ┃   ┃     +       ┃     7       ┃     8       ┃     9       ┃     -       ┃
// ┏━━━━━━━━━━━╋━━━━━━━━━━━━━╋━━━━━━━━━━━━━╋━━━━━━━━━━━━━╋━━━━━━━━━━━━━╋━━━━━━━━━━━━━┫   ┣━━━━━━━━━━━━━╋━━━━━━━━━━━━━╋━━━━━━━━━━━━━╋━━━━━━━━━━━━━╋━━━━━━━━━━━━━╋━━━━━━━━━━━┓
// ┃  LSHFT    ┃  osm LGUI   ┃  osm LALT   ┃  osm LSHIFT ┃   osm LCTRL ┃   Shift+G   ┃   ┃     0       ┃     4       ┃     5       ┃     6       ┃     +       ┃    /      ┃
// ┣━━━━━━━━━━━╋━━━━━━━━━━━━━╋━━━━━━━━━━━━━╋━━━━━━━━━━━━━╋━━━━━━━━━━━━━╋━━━━━━━━━━━━━┫   ┣━━━━━━━━━━━━━╋━━━━━━━━━━━━━╋━━━━━━━━━━━━━╋━━━━━━━━━━━━━╋━━━━━━━━━━━━━╋━━━━━━━━━━━┫
// ┃  swap     ┃             ┃   Cut       ┃    Copy     ┃  osm RALT   ┃   Paste     ┃   ┃     *       ┃     1       ┃     2       ┃     3       ┃     .       ┃  swap     ┃
// ┗━━━━━━━━━━━┻━━━━━━━━━━━━━┻━━━━━━━━━━━━━╋━━━━━━━━━━━━━╋━━━━━━━━━━━━━╋━━━━━━━━━━━━━┫   ┣━━━━━━━━━━━━━╋━━━━━━━━━━━━━╋━━━━━━━━━━━━━╋━━━━━━━━━━━━━┻━━━━━━━━━━━━━┻━━━━━━━━━━━┛
//                                         ┃    ESC      ┃    SPC      ┃    TAB      ┃   ┃   ENTER     ┃   BSPC      ┃   DELETE    ┃
//                                         ┗━━━━━━━━━━━━━┻━━━━━━━━━━━━━┻━━━━━━━━━━━━━┛   ┗━━━━━━━━━━━━━┻━━━━━━━━━━━━━┻━━━━━━━━━━━━━┛
bindings = <

// ╷           ╷             ╷             ╷             ╷             ╷             ╷   ╷             ╷             ╷             ╷             ╷             ╷           ╷

                &kp LEFT      &kp DOWN      &kp UP        &kp RIGHT     &kp F2            &kp KP_SLASH  &kp KP_N7     &kp KP_N8     &kp KP_N9     &kp KP_MINUS
     ___        &skl LGUI      &sk LALT      &sk LSHFT     &sk LCTRL     &kp LS(G)         &kp KP_N0     &kp KP_N4     &kp KP_N5     &kp KP_N6     &kp KP_PLUS    ___
     ___         XXX          &kp LC(FR_X)  &kp LC(FR_C)  &kp RALT      &kp LC(FR_V)      &kp KP_ASTERISK &kp KP_N1   &kp KP_N2     &kp KP_N3     &kp KP_DOT     ___
                                             ___           ___           ___               ___           ___           ___
                        >;
                };

snake_layer {
display-name= "SNAKE";
//             ┏━━━━━━━━━━━━━┳━━━━━━━━━━━━━┳━━━━━━━━━━━━━┳━━━━━━━━━━━━━┳━━━━━━━━━━━━━┓   ┏━━━━━━━━━━━━━┳━━━━━━━━━━━━━┳━━━━━━━━━━━━━┳━━━━━━━━━━━━━┳━━━━━━━━━━━━━┓
//             ┃             ┃    Cut      ┃    Copy     ┃    Paste    ┃             ┃   ┃             ┃  Wheel Up   ┃ Mouse Up    ┃  Wheel Down ┃             ┃
// ┏━━━━━━━━━━━╋━━━━━━━━━━━━━╋━━━━━━━━━━━━━╋━━━━━━━━━━━━━╋━━━━━━━━━━━━━╋━━━━━━━━━━━━━┫   ┣━━━━━━━━━━━━━╋━━━━━━━━━━━━━╋━━━━━━━━━━━━━╋━━━━━━━━━━━━━╋━━━━━━━━━━━━━╋━━━━━━━━━━━┓
// ┃  LSHFT    ┃  osm LGUI   ┃  osm LALT   ┃  osm LSHIFT ┃   osm LCTRL ┃    ESC      ┃   ┃             ┃  Mouse Left ┃  Mouse Down ┃  Mouse Right┃             ┃    /      ┃
// ┣━━━━━━━━━━━╋━━━━━━━━━━━━━╋━━━━━━━━━━━━━╋━━━━━━━━━━━━━╋━━━━━━━━━━━━━╋━━━━━━━━━━━━━┫   ┣━━━━━━━━━━━━━╋━━━━━━━━━━━━━╋━━━━━━━━━━━━━╋━━━━━━━━━━━━━╋━━━━━━━━━━━━━╋━━━━━━━━━━━┫
// ┃  swap     ┃             ┃     RALT    ┃             ┃ Mouse Btn 4 ┃ Mouse Btn 5 ┃   ┃             ┃ Wheel Left  ┃             ┃ Wheel Right ┃             ┃  swap     ┃
// ┗━━━━━━━━━━━┻━━━━━━━━━━━━━┻━━━━━━━━━━━━━╋━━━━━━━━━━━━━╋━━━━━━━━━━━━━╋━━━━━━━━━━━━━┫   ┣━━━━━━━━━━━━━╋━━━━━━━━━━━━━╋━━━━━━━━━━━━━╋━━━━━━━━━━━━━┻━━━━━━━━━━━━━┻━━━━━━━━━━━┛
//                                         ┃ Mouse Btn L ┃ Mouse Btn M ┃ Mouse Btn R ┃   ┃ Mouse Btn L ┃ Mouse Btn M ┃ Mouse Btn R ┃
//                                         ┗━━━━━━━━━━━━━┻━━━━━━━━━━━━━┻━━━━━━━━━━━━━┛   ┗━━━━━━━━━━━━━┻━━━━━━━━━━━━━┻━━━━━━━━━━━━━┛
bindings = <

// ╷           ╷             ╷             ╷             ╷             ╷             ╷   ╷             ╷             ╷             ╷             ╷             ╷           ╷

                 ___           ___           ___           ___           ___               ___         ___           ___           ___            XXX
     ___         ___           ___           ___           ___           ___               ___         ___           ___           ___           ___           ___
     ___         ___           ___           ___           ___           ___               ___         ___           ___           ___           ___           ___
                                             ___           &ak_snake     &mo EXCEL         ___         ___           ___
                        >;
                };

camel_layer {
display-name= "CAMEL";
//             ┏━━━━━━━━━━━━━┳━━━━━━━━━━━━━┳━━━━━━━━━━━━━┳━━━━━━━━━━━━━┳━━━━━━━━━━━━━┓   ┏━━━━━━━━━━━━━┳━━━━━━━━━━━━━┳━━━━━━━━━━━━━┳━━━━━━━━━━━━━┳━━━━━━━━━━━━━┓
//             ┃             ┃    Cut      ┃    Copy     ┃    Paste    ┃             ┃   ┃             ┃  Wheel Up   ┃ Mouse Up    ┃  Wheel Down ┃             ┃
// ┏━━━━━━━━━━━╋━━━━━━━━━━━━━╋━━━━━━━━━━━━━╋━━━━━━━━━━━━━╋━━━━━━━━━━━━━╋━━━━━━━━━━━━━┫   ┣━━━━━━━━━━━━━╋━━━━━━━━━━━━━╋━━━━━━━━━━━━━╋━━━━━━━━━━━━━╋━━━━━━━━━━━━━╋━━━━━━━━━━━┓
// ┃  LSHFT    ┃  osm LGUI   ┃  osm LALT   ┃  osm LSHIFT ┃   osm LCTRL ┃    ESC      ┃   ┃             ┃  Mouse Left ┃  Mouse Down ┃  Mouse Right┃             ┃    /      ┃
// ┣━━━━━━━━━━━╋━━━━━━━━━━━━━╋━━━━━━━━━━━━━╋━━━━━━━━━━━━━╋━━━━━━━━━━━━━╋━━━━━━━━━━━━━┫   ┣━━━━━━━━━━━━━╋━━━━━━━━━━━━━╋━━━━━━━━━━━━━╋━━━━━━━━━━━━━╋━━━━━━━━━━━━━╋━━━━━━━━━━━┫
// ┃  swap     ┃             ┃     RALT    ┃             ┃ Mouse Btn 4 ┃ Mouse Btn 5 ┃   ┃             ┃ Wheel Left  ┃             ┃ Wheel Right ┃             ┃  swap     ┃
// ┗━━━━━━━━━━━┻━━━━━━━━━━━━━┻━━━━━━━━━━━━━╋━━━━━━━━━━━━━╋━━━━━━━━━━━━━╋━━━━━━━━━━━━━┫   ┣━━━━━━━━━━━━━╋━━━━━━━━━━━━━╋━━━━━━━━━━━━━╋━━━━━━━━━━━━━┻━━━━━━━━━━━━━┻━━━━━━━━━━━┛
//                                         ┃ Mouse Btn L ┃ Mouse Btn M ┃ Mouse Btn R ┃   ┃ Mouse Btn L ┃ Mouse Btn M ┃ Mouse Btn R ┃
//                                         ┗━━━━━━━━━━━━━┻━━━━━━━━━━━━━┻━━━━━━━━━━━━━┛   ┗━━━━━━━━━━━━━┻━━━━━━━━━━━━━┻━━━━━━━━━━━━━┛
bindings = <

// ╷           ╷             ╷             ╷             ╷             ╷             ╷   ╷             ╷             ╷             ╷             ╷             ╷           ╷

                 ___           ___           ___           ___           ___               ___         ___           ___           ___            XXX
     ___         ___           ___           ___           ___           ___               ___         ___           ___           ___           ___           ___
     ___         ___           ___           ___           ___           ___               ___         ___           ___           ___           ___           ___
                                             ___           &ak_camel     ___               ___         ___           ___
                        >;
                };

kebab_layer {
display-name= "KEBAB";
//             ┏━━━━━━━━━━━━━┳━━━━━━━━━━━━━┳━━━━━━━━━━━━━┳━━━━━━━━━━━━━┳━━━━━━━━━━━━━┓   ┏━━━━━━━━━━━━━┳━━━━━━━━━━━━━┳━━━━━━━━━━━━━┳━━━━━━━━━━━━━┳━━━━━━━━━━━━━┓
//             ┃             ┃    Cut      ┃    Copy     ┃    Paste    ┃             ┃   ┃             ┃  Wheel Up   ┃ Mouse Up    ┃  Wheel Down ┃             ┃
// ┏━━━━━━━━━━━╋━━━━━━━━━━━━━╋━━━━━━━━━━━━━╋━━━━━━━━━━━━━╋━━━━━━━━━━━━━╋━━━━━━━━━━━━━┫   ┣━━━━━━━━━━━━━╋━━━━━━━━━━━━━╋━━━━━━━━━━━━━╋━━━━━━━━━━━━━╋━━━━━━━━━━━━━╋━━━━━━━━━━━┓
// ┃  LSHFT    ┃  osm LGUI   ┃  osm LALT   ┃  osm LSHIFT ┃   osm LCTRL ┃    ESC      ┃   ┃             ┃  Mouse Left ┃  Mouse Down ┃  Mouse Right┃             ┃    /      ┃
// ┣━━━━━━━━━━━╋━━━━━━━━━━━━━╋━━━━━━━━━━━━━╋━━━━━━━━━━━━━╋━━━━━━━━━━━━━╋━━━━━━━━━━━━━┫   ┣━━━━━━━━━━━━━╋━━━━━━━━━━━━━╋━━━━━━━━━━━━━╋━━━━━━━━━━━━━╋━━━━━━━━━━━━━╋━━━━━━━━━━━┫
// ┃  swap     ┃             ┃     RALT    ┃             ┃ Mouse Btn 4 ┃ Mouse Btn 5 ┃   ┃             ┃ Wheel Left  ┃             ┃ Wheel Right ┃             ┃  swap     ┃
// ┗━━━━━━━━━━━┻━━━━━━━━━━━━━┻━━━━━━━━━━━━━╋━━━━━━━━━━━━━╋━━━━━━━━━━━━━╋━━━━━━━━━━━━━┫   ┣━━━━━━━━━━━━━╋━━━━━━━━━━━━━╋━━━━━━━━━━━━━╋━━━━━━━━━━━━━┻━━━━━━━━━━━━━┻━━━━━━━━━━━┛
//                                         ┃ Mouse Btn L ┃ Mouse Btn M ┃ Mouse Btn R ┃   ┃ Mouse Btn L ┃ Mouse Btn M ┃ Mouse Btn R ┃
//                                         ┗━━━━━━━━━━━━━┻━━━━━━━━━━━━━┻━━━━━━━━━━━━━┛   ┗━━━━━━━━━━━━━┻━━━━━━━━━━━━━┻━━━━━━━━━━━━━┛
bindings = <

// ╷           ╷             ╷             ╷             ╷             ╷             ╷   ╷             ╷             ╷             ╷             ╷             ╷           ╷

                 ___           ___           ___           ___           ___               ___         ___           ___           ___            XXX
     ___         ___           ___           ___           ___           ___               ___         ___           ___           ___           ___           ___
     ___         ___           ___           ___           ___           ___               ___         ___           ___           ___           ___           ___
                                             ___           &ak_kebab     &mo EXCEL         ___         ___           ___
                        >;
                };

path_layer {
display-name= "PATH_CASE";
//             ┏━━━━━━━━━━━━━┳━━━━━━━━━━━━━┳━━━━━━━━━━━━━┳━━━━━━━━━━━━━┳━━━━━━━━━━━━━┓   ┏━━━━━━━━━━━━━┳━━━━━━━━━━━━━┳━━━━━━━━━━━━━┳━━━━━━━━━━━━━┳━━━━━━━━━━━━━┓
//             ┃             ┃    Cut      ┃    Copy     ┃    Paste    ┃             ┃   ┃             ┃  Wheel Up   ┃ Mouse Up    ┃  Wheel Down ┃             ┃
// ┏━━━━━━━━━━━╋━━━━━━━━━━━━━╋━━━━━━━━━━━━━╋━━━━━━━━━━━━━╋━━━━━━━━━━━━━╋━━━━━━━━━━━━━┫   ┣━━━━━━━━━━━━━╋━━━━━━━━━━━━━╋━━━━━━━━━━━━━╋━━━━━━━━━━━━━╋━━━━━━━━━━━━━╋━━━━━━━━━━━┓
// ┃  LSHFT    ┃  osm LGUI   ┃  osm LALT   ┃  osm LSHIFT ┃   osm LCTRL ┃    ESC      ┃   ┃             ┃  Mouse Left ┃  Mouse Down ┃  Mouse Right┃             ┃    /      ┃
// ┣━━━━━━━━━━━╋━━━━━━━━━━━━━╋━━━━━━━━━━━━━╋━━━━━━━━━━━━━╋━━━━━━━━━━━━━╋━━━━━━━━━━━━━┫   ┣━━━━━━━━━━━━━╋━━━━━━━━━━━━━╋━━━━━━━━━━━━━╋━━━━━━━━━━━━━╋━━━━━━━━━━━━━╋━━━━━━━━━━━┫
// ┃  swap     ┃             ┃     RALT    ┃             ┃ Mouse Btn 4 ┃ Mouse Btn 5 ┃   ┃             ┃ Wheel Left  ┃             ┃ Wheel Right ┃             ┃  swap     ┃
// ┗━━━━━━━━━━━┻━━━━━━━━━━━━━┻━━━━━━━━━━━━━╋━━━━━━━━━━━━━╋━━━━━━━━━━━━━╋━━━━━━━━━━━━━┫   ┣━━━━━━━━━━━━━╋━━━━━━━━━━━━━╋━━━━━━━━━━━━━╋━━━━━━━━━━━━━┻━━━━━━━━━━━━━┻━━━━━━━━━━━┛
//                                         ┃ Mouse Btn L ┃ Mouse Btn M ┃ Mouse Btn R ┃   ┃ Mouse Btn L ┃ Mouse Btn M ┃ Mouse Btn R ┃
//                                         ┗━━━━━━━━━━━━━┻━━━━━━━━━━━━━┻━━━━━━━━━━━━━┛   ┗━━━━━━━━━━━━━┻━━━━━━━━━━━━━┻━━━━━━━━━━━━━┛
bindings = <

// ╷           ╷             ╷             ╷             ╷             ╷             ╷   ╷             ╷             ╷             ╷             ╷             ╷           ╷

                 ___           ___           ___           ___           ___               ___         ___           ___           ___            XXX
     ___         ___           ___           ___           ___           ___               ___         ___           ___           ___           ___           ___
     ___         ___           ___           ___           ___           ___               ___         ___           ___           ___           ___           ___
                                             ___           &ak_bslh      &mo EXCEL         ___         ___           ___
                        >;
                };
slsh_layer {
display-name= "SLSH_CASE";
//             ┏━━━━━━━━━━━━━┳━━━━━━━━━━━━━┳━━━━━━━━━━━━━┳━━━━━━━━━━━━━┳━━━━━━━━━━━━━┓   ┏━━━━━━━━━━━━━┳━━━━━━━━━━━━━┳━━━━━━━━━━━━━┳━━━━━━━━━━━━━┳━━━━━━━━━━━━━┓
//             ┃             ┃    Cut      ┃    Copy     ┃    Paste    ┃             ┃   ┃             ┃  Wheel Up   ┃ Mouse Up    ┃  Wheel Down ┃             ┃
// ┏━━━━━━━━━━━╋━━━━━━━━━━━━━╋━━━━━━━━━━━━━╋━━━━━━━━━━━━━╋━━━━━━━━━━━━━╋━━━━━━━━━━━━━┫   ┣━━━━━━━━━━━━━╋━━━━━━━━━━━━━╋━━━━━━━━━━━━━╋━━━━━━━━━━━━━╋━━━━━━━━━━━━━╋━━━━━━━━━━━┓
// ┃  LSHFT    ┃  osm LGUI   ┃  osm LALT   ┃  osm LSHIFT ┃   osm LCTRL ┃    ESC      ┃   ┃             ┃  Mouse Left ┃  Mouse Down ┃  Mouse Right┃             ┃    /      ┃
// ┣━━━━━━━━━━━╋━━━━━━━━━━━━━╋━━━━━━━━━━━━━╋━━━━━━━━━━━━━╋━━━━━━━━━━━━━╋━━━━━━━━━━━━━┫   ┣━━━━━━━━━━━━━╋━━━━━━━━━━━━━╋━━━━━━━━━━━━━╋━━━━━━━━━━━━━╋━━━━━━━━━━━━━╋━━━━━━━━━━━┫
// ┃  swap     ┃             ┃     RALT    ┃             ┃ Mouse Btn 4 ┃ Mouse Btn 5 ┃   ┃             ┃ Wheel Left  ┃             ┃ Wheel Right ┃             ┃  swap     ┃
// ┗━━━━━━━━━━━┻━━━━━━━━━━━━━┻━━━━━━━━━━━━━╋━━━━━━━━━━━━━╋━━━━━━━━━━━━━╋━━━━━━━━━━━━━┫   ┣━━━━━━━━━━━━━╋━━━━━━━━━━━━━╋━━━━━━━━━━━━━╋━━━━━━━━━━━━━┻━━━━━━━━━━━━━┻━━━━━━━━━━━┛
//                                         ┃ Mouse Btn L ┃ Mouse Btn M ┃ Mouse Btn R ┃   ┃ Mouse Btn L ┃ Mouse Btn M ┃ Mouse Btn R ┃
//                                         ┗━━━━━━━━━━━━━┻━━━━━━━━━━━━━┻━━━━━━━━━━━━━┛   ┗━━━━━━━━━━━━━┻━━━━━━━━━━━━━┻━━━━━━━━━━━━━┛
bindings = <

// ╷           ╷             ╷             ╷             ╷             ╷             ╷   ╷             ╷             ╷             ╷             ╷             ╷           ╷

                 ___           ___           ___           ___           ___               ___         ___           ___           ___            XXX
     ___         ___           ___           ___           ___           ___               ___         ___           ___           ___           ___           ___
     ___         ___           ___           ___           ___           ___               ___         ___           ___           ___           ___           ___
                                             ___           &ak_slash     &mo EXCEL         ___         ___           ___
                        >;
                };
       };

};
